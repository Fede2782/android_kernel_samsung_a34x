// SPDX-License-Identifier: (GPL-2.0 OR MIT)
/*
 * Copyright (C) 2021 MediaTek Inc.
 * Author: Owen Chen <owen.chen@mediatek.com>
 */

&disable_unused {
	status = "okay";
	disable-unused-clk-infracg_config {
		compatible = "mediatek,clk-disable-unused";
		clocks =
			<&infracfg_ao_clk CLK_IFRAO_PMIC_AP_SET>,
			<&infracfg_ao_clk CLK_IFRAO_PMIC_TMR_SET>,
			<&infracfg_ao_clk CLK_IFRAO_THERM>,
			<&infracfg_ao_clk CLK_IFRAO_AUDIO_26M_BCLK>,
			<&infracfg_ao_clk CLK_IFRAO_AUDIO>,
			<&infracfg_ao_clk CLK_IFRAO_CLDMA_BCLK>,
			<&infracfg_ao_clk CLK_IFRAO_DEVICE_APC>,
			<&infracfg_ao_clk CLK_IFRAO_CCIF_AP>,
			<&infracfg_ao_clk CLK_IFRAO_CCIF_MD>,
			<&infracfg_ao_clk CLK_IFRAO_CCIF1_AP>,
			<&infracfg_ao_clk CLK_IFRAO_CCIF1_MD>,
			<&infracfg_ao_clk CLK_IFRAO_CCIF4_MD>,
			<&infracfg_ao_clk CLK_IFRAO_CCIF5_MD>,
			<&infracfg_ao_clk CLK_IFRAO_CCIF2_AP>,
			<&infracfg_ao_clk CLK_IFRAO_CCIF2_MD>,
			<&infracfg_ao_clk CLK_IFRAO_CQ_DMA>,
			<&infracfg_ao_clk CLK_IFRAO_AP_DMA>,
			<&infracfg_ao_clk CLK_IFRAO_GCE>,
			<&infracfg_ao_clk CLK_IFRAO_GCE_26M_SET>,
			<&infracfg_ao_clk CLK_IFRAO_AUXADC>,
			<&infracfg_ao_clk CLK_IFRAO_UART0>,
			<&infracfg_ao_clk CLK_IFRAO_UART1>,
			<&infracfg_ao_clk CLK_IFRAO_UART2>,
			<&infracfg_ao_clk CLK_IFRAO_UART3>,
			<&infracfg_ao_clk CLK_IFRAO_SPI0>,
			<&infracfg_ao_clk CLK_IFRAO_BTIF>,
			<&infracfg_ao_clk CLK_IFRAO_AP_DMA>,
			<&infracfg_ao_clk CLK_IFRAO_SPI1>,
			<&infracfg_ao_clk CLK_IFRAO_SPI2>,
			<&infracfg_ao_clk CLK_IFRAO_SPI3>,
			<&infracfg_ao_clk CLK_IFRAO_SPI4>,
			<&infracfg_ao_clk CLK_IFRAO_SPI5>,
			<&infracfg_ao_clk CLK_IFRAO_SPI6_CK>,
			<&infracfg_ao_clk CLK_IFRAO_SPI7_CK>,
			<&infracfg_ao_clk CLK_IFRAO_SSUSB>,
			<&infracfg_ao_clk CLK_IFRAO_SSUSB_XHCI>,
			<&infracfg_ao_clk CLK_IFRAO_UFS>,
			<&infracfg_ao_clk CLK_IFRAO_UNIPRO_SYSCLK>,
			<&infracfg_ao_clk CLK_IFRAO_UFS_MP_SAP_BCLK>,
			<&infracfg_ao_clk CLK_IFRAO_UFS_AES>,
			<&infracfg_ao_clk CLK_IFRAO_MSDC0_SRC>,
			<&infracfg_ao_clk CLK_IFRAO_MSDC0>,
			<&infracfg_ao_clk CLK_IFRAO_MSDC0_AES>,
			<&infracfg_ao_clk CLK_IFRAO_MSDC1_SRC>,
			<&infracfg_ao_clk CLK_IFRAO_MSDC1>,
			<&infracfg_ao_clk CLK_IFRAO_DISP_PWM>,
			<&infracfg_ao_clk CLK_IFRAO_PWM_HCLK>,
			<&infracfg_ao_clk CLK_IFRAO_PWM1>,
			<&infracfg_ao_clk CLK_IFRAO_PWM2>,
			<&infracfg_ao_clk CLK_IFRAO_PWM3>,
			<&infracfg_ao_clk CLK_IFRAO_PWM4>,
			<&infracfg_ao_clk CLK_IFRAO_PWM>,
			<&infracfg_ao_clk CLK_IFRAO_CPUM>,
			<&infracfg_ao_clk CLK_APUC_MD32>,
			<&infracfg_ao_clk CLK_APUC_MD32_32K>,
			<&infracfg_ao_clk CLK_IFRAO_FLASHIF_TOP_HCLK_133M>,
			<&infracfg_ao_clk CLK_IFRAO_RG_FLASHIF_PERI_26M_CK>,
			<&infracfg_ao_clk CLK_IFRAO_CCIF4_AP>;
	};

	disable-unused-clk-topckgen {
		compatible = "mediatek,clk-disable-unused";
		clocks =
			<&topckgen_clk CLK_TOP_MFG_PLL_SEL>,
			<&topckgen_clk CLK_TOP_IMG1_SEL>,
			<&topckgen_clk CLK_TOP_IMG2_SEL>,
			<&topckgen_clk CLK_TOP_IPE_SEL>,
			<&topckgen_clk CLK_TOP_VDEC_SEL>,
			<&topckgen_clk CLK_TOP_VENC_SEL>,
			<&topckgen_clk CLK_TOP_MDP_SEL>,
			<&topckgen_clk CLK_TOP_DISP_SEL>,
			<&topckgen_clk CLK_TOP_AUD_INTBUS_SEL>,
			<&topckgen_clk CLK_TOP_ADSP_SEL>,
			<&topckgen_clk CLK_TOP_CAM_SEL>,
			<&topckgen_clk CLK_TOP_DPMAIF_MAIN_SEL>,
			<&topckgen_clk CLK_TOP_SPMI_MST_SEL>,
			<&topckgen_clk CLK_TOP_TCK_26M_MX9>,
			<&topckgen_clk CLK_TOP_UNIVPLL_D4>,
			<&topckgen_clk CLK_TOP_ADSPPLL>,
			<&topckgen_clk CLK_TOP_MAINPLL_D6>,
			<&topckgen_clk CLK_TOP_UNIVPLL_D6>,
			<&topckgen_clk CLK_TOP_MAINPLL_D4_D2>,
			<&topckgen_clk CLK_TOP_MAINPLL_D4>,
			<&topckgen_clk CLK_TOP_MAINPLL_D7>,
			<&topckgen_clk CLK_TOP_MAINPLL_D5_D4>,
			<&topckgen_clk CLK_TOP_SPI_SEL>,
			<&topckgen_clk CLK_TOP_MAINPLL_D5_D4>,
			<&topckgen_clk CLK_TOP_SPI_SEL>,
			<&topckgen_clk CLK_TOP_MAINPLL_D5_D4>,
			<&topckgen_clk CLK_TOP_SPI_SEL>,
			<&topckgen_clk CLK_TOP_MAINPLL_D5_D4>,
			<&topckgen_clk CLK_TOP_AUDIO_SEL>,
			<&topckgen_clk CLK_TOP_MAINPLL_D4_D4>,
			<&topckgen_clk CLK_TOP_AUD_1_SEL>,
			<&topckgen_clk CLK_TOP_APLL1>,
			<&topckgen_clk CLK_TOP_AUD_2_SEL>,
			<&topckgen_clk CLK_TOP_APLL2>,
			<&topckgen_clk CLK_TOP_AUD_ENGEN1_SEL>,
			<&topckgen_clk CLK_TOP_APLL1_D4>,
			<&topckgen_clk CLK_TOP_AUD_ENGEN2_SEL>,
			<&topckgen_clk CLK_TOP_APLL2_D4>,
			<&topckgen_clk CLK_TOP_APLL_I2S0_MCK_SEL>,
			<&topckgen_clk CLK_TOP_APLL_I2S1_MCK_SEL>,
			<&topckgen_clk CLK_TOP_APLL_I2S2_MCK_SEL>,
			<&topckgen_clk CLK_TOP_APLL_I2S3_MCK_SEL>,
			<&topckgen_clk CLK_TOP_APLL_I2S4_MCK_SEL>,
			<&topckgen_clk CLK_TOP_APLL_I2S5_MCK_SEL>,
			<&topckgen_clk CLK_TOP_APLL12_CK_DIV0>,
			<&topckgen_clk CLK_TOP_APLL12_CK_DIV1>,
			<&topckgen_clk CLK_TOP_APLL12_CK_DIV2>,
			<&topckgen_clk CLK_TOP_APLL12_CK_DIV3>,
			<&topckgen_clk CLK_TOP_APLL12_CK_DIV4>,
			<&topckgen_clk CLK_TOP_APLL12_CK_DIVB>,
			<&topckgen_clk CLK_TOP_APLL12_CK_DIV5>,
			<&topckgen_clk CLK_TOP_AUDIO_H_SEL>,
			<&topckgen_clk CLK_TOP_AES_UFSFDE_SEL>,
			<&topckgen_clk CLK_TOP_MAINPLL_D4>,
			<&topckgen_clk CLK_TOP_MSDC50_0_HCLK_SEL>,
			<&topckgen_clk CLK_TOP_MFG_REF_SEL>,
			<&topckgen_clk CLK_TOP_DPE_SEL>,	/* 4 */
			<&topckgen_clk CLK_TOP_CCU_SEL>,	/* 9 */
			<&topckgen_clk CLK_TOP_MAINPLL_D4>,	/* 10 */
			<&topckgen_clk CLK_TOP_MMPLL_D7>,	/* 16 */
			<&topckgen_clk CLK_TOP_MMPLL_D4_D2>,	/* 18 */
			<&topckgen_clk CLK_TOP_MMPLL_D5_D2>,	/* 19 */
			<&topckgen_clk CLK_TOP_MMPLL_D6>,	/* 20 */
			<&topckgen_clk CLK_TOP_UNIVPLL_D5_D2>,	/* 22 */
			<&topckgen_clk CLK_TOP_MAINPLL_D5_D2>,	/* 23 */
			<&topckgen_clk CLK_TOP_DSP_SEL>,
			<&topckgen_clk CLK_TOP_DSP1_NPUPLL_SEL>,
			<&topckgen_clk CLK_TOP_DSP2_NPUPLL_SEL>,
			<&topckgen_clk CLK_TOP_IPU_IF_SEL>,
			<&topckgen_clk CLK_TOP_UNIVPLL_D6_D2>,
			<&topckgen_clk CLK_TOP_UNIVPLL_D4_D2>,
			<&topckgen_clk CLK_TOP_MAINPLL_D4>,
			<&topckgen_clk CLK_TOP_TVDPLL>,
			<&topckgen_clk CLK_TOP_MAINPLL_D9>,
			<&topckgen_clk CLK_TOP_UNIVPLL_D5>,
			<&topckgen_clk CLK_TOP_MAINPLL_D3>,
			<&topckgen_clk CLK_TOP_UNIVPLL_D3>,
			<&topckgen_clk CLK_TOP_DSP1_SEL_CK>,
			<&topckgen_clk CLK_TOP_DSP2_SEL_CK>,
			<&topckgen_clk CLK_TOP_DSP1_NPUPLL_SEL>,
			<&topckgen_clk CLK_TOP_DSP2_NPUPLL_SEL>,
			<&topckgen_clk CLK_TOP_NPUPLL>,
			<&topckgen_clk CLK_TOP_SENINF_SEL>,
			<&topckgen_clk CLK_TOP_SENINF1_SEL>,
			<&topckgen_clk CLK_TOP_SENINF2_SEL>,
			<&topckgen_clk CLK_TOP_CAMTG_SEL>,
			<&topckgen_clk CLK_TOP_CAMTG2_SEL>,
			<&topckgen_clk CLK_TOP_CAMTG3_SEL>,
			<&topckgen_clk CLK_TOP_CAMTG4_SEL>,
			<&topckgen_clk CLK_TOP_CAMTG5_SEL>,
			<&topckgen_clk CLK_TOP_UNIVPLL_192M_D8>,
			<&topckgen_clk CLK_TOP_UNIVPLL_D6_D8>,
			<&topckgen_clk CLK_TOP_UNIVPLL_192M_D4>,
			<&topckgen_clk CLK_TOP_CSW_F26M_CK_D2>,
			<&topckgen_clk CLK_TOP_UNIVPLL_192M_D16>,
			<&topckgen_clk CLK_TOP_UNIVPLL_192M_D32>,
			<&topckgen_clk CLK_TOP_CAMTM_SEL>,
			<&topckgen_clk CLK_TOP_CCU_SEL>,
			<&topckgen_clk CLK_TOP_DPE_SEL>,
			<&topckgen_clk CLK_TOP_DPE>,
			<&topckgen_clk CLK_TOP_DISP_PWM_SEL>;

	};
};
