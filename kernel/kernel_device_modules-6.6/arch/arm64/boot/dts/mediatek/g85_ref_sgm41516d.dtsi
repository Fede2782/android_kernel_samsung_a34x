// SPDX-License-Identifier: GPL-2.0
/*
 * Copyright (c) 2022 MediaTek Inc.
 */

&i2c5 {
	sgm41516d:sgm41516d@6B{
		compatible = "mediatek,sgm41516d";
		reg = <0x6B>;
		charger_name = "primary_chg";
		/* add for interrupt start */
		sgm41516d,intr_gpio_num = <9>; /* direct defined GPIO num */
		sgm41516d,intr_gpio = <&pio 9 0x0>; /* GPIO */
		/*add for interrupt end   */
		status = "okay";
	};
};
