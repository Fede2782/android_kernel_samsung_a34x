// SPDX-License-Identifier: GPL-2.0
/*
 * Copyright (c) 2021 MediaTek Inc.
 */

&mtk_gauge {
	difference-fullocv-ith = <(200)>;
/*	Charging termination current*/
	shutdown-1-time = <(5)>;
/*	If ui_soc shows 1% more than X minites, system will shutdown*/
	keep-100-percent = <(1)>;
/*	The ui_soc will keep 100% until SOC drop X percents after unplugged*/
	r-fg-value = <(5)>;
/*	R_sense resistance*/
	embedded-sel = <(0)>;
/*	Configures whether using embedded battery or not*/
	pmic-shutdown-current = <(20)>;
/*	System shutdown current*/
	fg-meter-resistance = <(100)>;
/*	The resistance of PCB*/
	car-tune-value = <(100)>;
/*	Tune value for current measurement*/
	pmic-min-vol = <(33500)>;
/*	vboot voltage for gauge 0%*/
	poweron-system-iboot = <(500)>;
/*	power on system iboot*/
	shutdown-gauge0-voltage = <(34000)>;
/*	shutdown gauge 0% voltage*/
	temperature-t0 = <(50)>;
/*	Battery temperature T0*/
	temperature-t1 = <(25)>;
/*	Battery temperature T1*/
	temperature-t2 = <(10)>;
/*	Battery temperature T2*/
	temperature-t3 = <(0)>;
/*	Battery temperature T3*/
	temperature-t4 = <(-10)>;
/*	Battery temperature T4*/
	g-fg-pseudo100-t0 = <(100)>;
/*	Pseudo 100% percentage at T0*/
	g-fg-pseudo100-t1 = <(100)>;
/*	Pseudo 100% percentage at T1*/
	g-fg-pseudo100-t2 = <(100)>;
/*	Pseudo 100% percentage at T2*/
	g-fg-pseudo100-t3 = <(100)>;
/*	Pseudo 100% percentage at T3*/
	g-fg-pseudo100-t4 = <(100)>;
/*	Pseudo 100% percentage at T4*/
	q-max-sys-voltage-bat0 = <(3350)>;
/*	Pseudo1 for hide percentage*/
	q-max-sys-voltage-bat1 = <(3350)>;
/*	Pseudo1 for hide percentage*/
	q-max-sys-voltage-bat2 = <(3350)>;
/*	Pseudo1 for hide percentage*/
	q-max-sys-voltage-bat3 = <(3350)>;
/*	Pseudo1 for hide percentage*/
	com-fg-meter-resistance = <(100)>;
/*	compensate The resistance of PCB*/
	com-r-fg-value = <(0)>;
/*	compensate R_sense resistance*/
	enable-tmp-intr-suspend = <(0)>;
/*	Enable update temp when suspend */
	active-table = <(0)>;
/*	Table numbers per battery*/
	multi-temp-gauge0 = <(1)>;
/*	Multi gauge0 enable*/
	rbat-pull-up-volt = <(2800)>;
/*	Rbat pull up voltage*/
#include "mt6877_battery_table.dtsi"
#include "mt6877_battery_prop_dim2_ext.dtsi"
};
