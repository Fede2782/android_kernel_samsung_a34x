// SPDX-License-Identifier: GPL-2.0
/*
 * Copyright (c) 2019 MediaTek Inc.
 */

&mtk_gauge {
	RBAT_TYPE = <(100)>;
	RBAT_PULL_UP_R = <(100000)>;

	rbat_temperature_table_num = <21>;
	rbat_battery_temperature =
	<
		(-40) 4397119
		(-35) 3088598
		(-30) 2197225
		(-25) 1581880
		(-20) 1151036
		(-15) 846578
		(-10) 628988
		(-5) 471632
		0 357011
		5 272499
		10 209709
		15 162650
		20 127080
		25 100000
		30 79221
		35 63167
		40 50676
		45 40903
		50 33194
		55 27090
		60 22224 >;
/* battery temperature table type - NTC table */
	batteryid-gpio1 = <&pio 21 0>;
	batteryid-gpio = <&pio 22 0>;
/* Battery ID distinction */
	difference-fullocv-ith = <(300)>; /* M53 : 250mA +50mA */
/*	Charging termination current*/
	shutdown-1-time = <(60)>;
/*	If ui_soc shows 1% more than X minites, system will shutdown*/
	car-tune-value = <(100)>;
/*	Tune value for current measurement*/
	shutdown-gauge0 = <(0)>;
/*	shutdown gauge 0% voltage*/
	temperature-t0 = <(50)>;
/*	Battery temperature T0*/
	temperature-t1 = <(25)>;
/*	Battery temperature T1*/
	temperature-t2 = <(10)>;
/*	Battery temperature T2*/
	temperature-t3 = <(0)>;
/*	Battery temperature T3*/
	temperature-t4 = <(-10)>;
/*	Battery temperature T4*/
	temperature-t5 = <(-20)>;
/*	Battery temperature T5*/
	enable_tmp_intr_suspend = <(0)>;
/* Enable update temp when suspend */
	active-table = <(6)>;
/* Table numbers per battery*/
	HWOCV_OLDOCV_DIFF = <(100)>;
/* Diff of HWOCV and SWOCV*/
	UI_FULL_LIMIT_EN = <(1)>;
	UI_FULL_LIMIT_SOC0 = <(9545)>;
	UI_FULL_LIMIT_ITH0 = <(14000)>;
	UI_FULL_LIMIT_SOC1 = <(9645)>;
	UI_FULL_LIMIT_ITH1 = <(12500)>;
	UI_FULL_LIMIT_SOC2 = <(9745)>;
	UI_FULL_LIMIT_ITH2 = <(11000)>;
	UI_FULL_LIMIT_SOC3 = <(9845)>;
	UI_FULL_LIMIT_ITH3 = <(9500)>;
	UI_FULL_LIMIT_SOC4 = <(9945)>;
	UI_FULL_LIMIT_ITH4 = <(7700)>;
/* Using current to limit uisoc in 100% case*/
	DYNAMIC_CV_FACTOR = <(100)>;
/* Dynamic CV offset */
	CHARGER_IEOC = <(250)>;
/* Charger termination current for Dynamic CV */
	nouse-baton-undet;
/* no use battery undetect by baton */
#include "battery_table.dtsi"
#include "battery_prop_dim2_ext.dtsi"
};
