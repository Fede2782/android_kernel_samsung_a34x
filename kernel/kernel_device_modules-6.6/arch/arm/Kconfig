## kernel/kernel_device_modules-6.6/drivers/input/touchscreen/Kconfig
```kconfig
# SPDX-License-Identifier: GPL-2.0-only
#
# Touchscreen driver configuration
#

if INPUT_TOUCHSCREEN

config TOUCHSCREEN_MTK_TOUCH
       string "Touch IC name for Mediatek package"
       help
         Set touch IC name if you have touch panel.

         To compile this dirver for used touch IC.

config TOUCHSCREEN_MT6985_ALPHA_SUPPORT
       tristate "Specify Alpha Touch Platform is mt6985"
       help
         Select Alpha Touch Platform is mt6985.
         To compile this dirver for used touch IC.
         Set Y or M to select this feature for specific platform-mt6985,
         and set N to disable.

config TOUCHSCREEN_ILITEK_TOUCH
       tristate "ILITEK TOUCHSCREEN"
       help
         Set Y or M to select this feature for touch compile,
         and set N to disable.

config TOUCHSCREEN_BOTAI_MULTI_TOUCH
       tristate "GT9XX MULTIPLE TOUCHSCREEN"
       help
         Set Y or M to select this feature for touch compile,
         and set N to disable.for BoTai touch feature.

config TOUCHSCREEN_GT9XX
       tristate "GT9XX TOUCHSCREEN FOR CAR SERDES TOUCH"
       help
         Set Y or M to select this feature for touch compile,
         and set N to disable.for car serdes touch feature.

config TOUCHSCREEN_FOCALTECH_TOUCH
       tristate "FOCALTECH TOUCHSCREEN"
       help
         Set Y or M to select this feature for touch compile,
         and set N to disable.for car serdes touch feature.

source "$(KCONFIG_EXT_PREFIX)drivers/input/touchscreen/BoTai_Multi_Touch/Kconfig"
source "$(KCONFIG_EXT_PREFIX)drivers/input/touchscreen/gt9xx/Kconfig"
source "$(KCONFIG_EXT_PREFIX)drivers/input/touchscreen/ILITEK/Kconfig"
source "$(KCONFIG_EXT_PREFIX)drivers/input/touchscreen/synaptics_dsx_96789/Kconfig"
source "$(KCONFIG_EXT_PREFIX)drivers/input/touchscreen/synaptics_dsx_96851/Kconfig"
source "$(KCONFIG_EXT_PREFIX)drivers/input/touchscreen/NT36532/Kconfig"
source "$(KCONFIG_EXT_PREFIX)drivers/input/touchscreen/GT6936/Kconfig"

endif
```

## kernel/kernel_device_modules-6.6/drivers/interconnect/mediatek/Kconfig
```kconfig
config INTERCONNECT_MTK
	bool "Mediatek Network-on-Chip interconnect drivers"
	depends on ARCH_MEDIATEK
	help
	  Support for Mediatek's Network-on-Chip interconnect hardware.

config INTERCONNECT_MTK_EMI
	tristate "Mediatek EMI interconnect driver"
	depends on INTERCONNECT_MTK
	depends on (MTK_DVFSRC && OF)
	help
	  This is a driver for the Mediatek Network-on-Chip on DVFSRC-based
	  platforms.

config INTERCONNECT_MTK_MMQOS_COMMON
	tristate "Mediatek MMQoS support"
	select INTERCONNECT_MTK_EXTENSION
	help
	  Support for multimedia QoS in Mediatek's SoCs.
	  The Mediatek MMQoS(Multimedia Quality of Service) Interconnect
	  driver will collect BW requests from MM users, such as display,
	  camera, mdp and video codec, and configure SMI settings dynamically
	  according to the aggregated BW.

config INTERCONNECT_MTK_MMQOS_MT6873
	tristate "Mediatek MT6873 MMQoS interconnect driver"
	depends on INTERCONNECT_MTK
	depends on DEVICE_MODULES_MTK_SMI
	select INTERCONNECT_MTK_MMQOS_COMMON
	help
	  Support MT6873 for multimedia QoS in Mediatek's SoCs.
	  The Mediatek MMQoS(Multimedia Quality of Service) Interconnect
	  driver will collect BW requests from MM users, such as display,
	  camera, mdp and video codec, and configure SMI settings dynamically
	  according to the aggregated BW.

config INTERCONNECT_MTK_MMQOS_MT6853
	tristate "Mediatek MT6853 MMQoS interconnect driver"
	depends on INTERCONNECT_MTK
	depends on DEVICE_MODULES_MTK_SMI
	select INTERCONNECT_MTK_MMQOS_COMMON
	help
	  Support MT6853 for multimedia QoS in Mediatek's SoCs.
	  The Mediatek MMQoS(Multimedia Quality of Service) Interconnect
	  driver will collect BW requests from MM users, such as display,
	  camera, mdp and video codec, and configure SMI settings dynamically
	  according to the aggregated BW.

config INTERCONNECT_MTK_MMQOS_MT6886
	tristate "Mediatek MT6886 MMQoS interconnect driver"
	depends on INTERCONNECT_MTK
	depends on DEVICE_MODULES_MTK_SMI
	select INTERCONNECT_MTK_MMQOS_COMMON
	help
	  Support MT6886 for multimedia QoS in Mediatek's SoCs.
	  The Mediatek MMQoS(Multimedia Quality of Service) Interconnect
	  driver will collect BW requests from MM users, such as display,
	  camera, mdp and video codec, and configure SMI settings dynamically
	  according to the aggregated BW.

config INTERCONNECT_MTK_MMQOS_MT6893
	tristate "Mediatek MT6893 MMQoS interconnect driver"
	depends on INTERCONNECT_MTK
	depends on DEVICE_MODULES_MTK_SMI
	select INTERCONNECT_MTK_MMQOS_COMMON
	help
	  Support MT6893 for multimedia QoS in Mediatek's SoCs.
	  The Mediatek MMQoS(Multimedia Quality of Service) Interconnect
	  driver will collect BW requests from MM users, such as display,
	  camera, mdp and video codec, and configure SMI settings dynamically
	  according to the aggregated BW.

config INTERCONNECT_MTK_MMQOS_MT6897
	tristate "Mediatek MT6897 MMQoS interconnect driver"
	depends on INTERCONNECT_MTK
	depends on DEVICE_MODULES_MTK_SMI
	select INTERCONNECT_MTK_MMQOS_COMMON
	help
	  Support MT6897 for multimedia QoS in Mediatek's SoCs.
	  The Mediatek MMQoS(Multimedia Quality of Service) Interconnect
	  driver will collect BW requests from MM users, such as display,
	  camera, mdp and video codec, and configure SMI settings dynamically
	  according to the aggregated BW.

config INTERCONNECT_MTK_MMQOS_MT6983
	tristate "Mediatek MT6983 MMQoS interconnect driver"
	depends on INTERCONNECT_MTK
	depends on DEVICE_MODULES_MTK_SMI
	select INTERCONNECT_MTK_MMQOS_COMMON
	help
	  Support MT6983 for multimedia QoS in Mediatek's SoCs.
	  The Mediatek MMQoS(Multimedia Quality of Service) Interconnect
	  driver will collect BW requests from MM users, such as display,
	  camera, mdp and video codec, and configure SMI settings dynamically
	  according to the aggregated BW.

config INTERCONNECT_MTK_MMQOS_MT6985
	tristate "Mediatek MT6985 MMQoS interconnect driver"
	depends on INTERCONNECT_MTK
	depends on DEVICE_MODULES_MTK_SMI
	select INTERCONNECT_MTK_MMQOS_COMMON
	help
	  Support MT6985 for multimedia QoS in Mediatek's SoCs.
	  The Mediatek MMQoS(Multimedia Quality of Service) Interconnect
	  driver will collect BW requests from MM users, such as display,
	  camera, mdp and video codec, and configure SMI settings dynamically
	  according to the aggregated BW.

config INTERCONNECT_MTK_MMQOS_MT6768
	tristate "Mediatek MT6768 MMQoS interconnect driver"
	depends on INTERCONNECT_MTK
	depends on DEVICE_MODULES_MTK_SMI
	select INTERCONNECT_MTK_MMQOS_COMMON
	help
	  Support MT6768 for multimedia QoS in Mediatek's SoCs.
	  The Mediatek MMQoS(Multimedia Quality of Service) Interconnect
	  driver will collect BW requests from MM users, such as display,
	  camera, mdp and video codec, and configure SMI settings dynamically
	  according to the aggregated BW.

config INTERCONNECT_MTK_MMQOS_MT6761
	tristate "Mediatek MT6761 MMQoS interconnect driver"
	depends on INTERCONNECT_MTK
	depends on DEVICE_MODULES_MTK_SMI
	select INTERCONNECT_MTK_MMQOS_COMMON
	help
	  Support MT6761 for multimedia QoS in Mediatek's SoCs.
	  The Mediatek MMQoS(Multimedia Quality of Service) Interconnect
	  driver will collect BW requests from MM users, such as display,
	  camera, mdp and video codec, and configure SMI settings dynamically
	  according to the aggregated BW.

config MTK_MMQOS_VCP
	tristate "MediaTek MMQOS VCP Support"
	depends on ARCH_MEDIATEK || COMPILE_TEST
	depends on INTERCONNECT_MTK
	depends on DEVICE_MODULES_MTK_SMI
	help
	  Say yes here to add support for the MediaTek Multimedia QoS (MMQOS)
	  for Video Control Processor (VCP). The MMQOS is used to set bw
	  for Mediatek multimedia hardwares, such as display, camera, mdp and
	  video codec. And VCP support is for video codec set bw in tinysys vcp.
	  Say no if your device does not need to MMQoS support in VCP.

config INTERCONNECT_MTK_MMQOS_MT6989
	tristate "Mediatek MT6989 MMQoS interconnect driver"
	depends on INTERCONNECT_MTK
	depends on DEVICE_MODULES_MTK_SMI
	select INTERCONNECT_MTK_MMQOS_COMMON
	help
	  Support MT6989 for multimedia QoS in Mediatek's SoCs.
	  The Mediatek MMQoS(Multimedia Quality of Service) Interconnect
	  driver will collect BW requests from MM users, such as display,
	  camera, mdp and video codec, and configure SMI settings dynamically
	  according to the aggregated BW.

config INTERCONNECT_MTK_MMQOS_MT6991
	tristate "Mediatek MT6991 MMQoS interconnect driver"
	depends on INTERCONNECT_MTK
	depends on DEVICE_MODULES_MTK_SMI
	select INTERCONNECT_MTK_MMQOS_COMMON
	help
	  Support MT6991 for multimedia QoS in Mediatek's SoCs.
	  The Mediatek MMQoS(Multimedia Quality of Service) Interconnect
	  driver will collect BW requests from MM users, such as display,
	  camera, mdp and video codec, and configure SMI settings dynamically
	  according to the aggregated BW.

config INTERCONNECT_MTK_MMQOS_MT6765
	tristate "Mediatek MT6765 MMQoS interconnect driver"
	depends on INTERCONNECT_MTK
	depends on DEVICE_MODULES_MTK_SMI
	select INTERCONNECT_MTK_MMQOS_COMMON
	help
	  Support MT6765 multimedia QoS in Mediatek's SoCs.
	  The Mediatek MMQoS(Multimedia Quality of Service) Interconnect
	  driver will collect BW requests from MM users, such as display,
	  camera, mdp and video codec, and configure SMI settings dynamically
	  according to the aggregated BW.

config INTERCONNECT_MTK_MMQOS_MT6877
	tristate "Mediatek MT6877 MMQoS interconnect driver"
	depends on INTERCONNECT_MTK
	depends on DEVICE_MODULES_MTK_SMI
	select INTERCONNECT_MTK_MMQOS_COMMON
	help
	  Support MT6877 for multimedia QoS in Mediatek's SoCs.
	  The Mediatek MMQoS(Multimedia Quality of Service) Interconnect
	  driver will collect BW requests from MM users, such as display,
	  camera, mdp and video codec, and configure SMI settings dynamically
	  according to the aggregated BW.

config INTERCONNECT_MTK_MMQOS_MT6781
	tristate "Mediatek MT6781 MMQoS interconnect driver"
	depends on INTERCONNECT_MTK
	depends on DEVICE_MODULES_MTK_SMI
	select INTERCONNECT_MTK_MMQOS_COMMON
	help
	  Support MT6781 multimedia QoS in Mediatek's SoCs.

config INTERCONNECT_MTK_MMQOS_V6833
	tristate "Mediatek MT6833 MMQoS interconnect driver"
	depends on INTERCONNECT_MTK
	depends on DEVICE_MODULES_MTK_SMI
	select INTERCONNECT_MTK_MMQOS_COMMON
	help
	  Support MT6833 multimedia QoS in Mediatek's SoCs.
	  The Mediatek MMQoS(Multimedia Quality of Service) Interconnect
	  driver will collect BW requests from MM users, such as display,
	  camera, mdp and video codec, and configure SMI settings dynamically
	  according to the aggregated BW.

config INTERCONNECT_MTK_MMQOS_MT6899
	tristate "Mediatek MT6899 MMQoS interconnect driver"
	depends on INTERCONNECT_MTK
	depends on DEVICE_MODULES_MTK_SMI
	select INTERCONNECT_MTK_MMQOS_COMMON
	help
	  Support MT6899 multimedia QoS in Mediatek's SoCs.
	  The Mediatek MMQoS(Multimedia Quality of Service) Interconnect
	  driver will collect BW requests from MM users, such as display,
	  camera, mdp and video codec, and configure SMI settings dynamically
	  according to the aggregated BW.
```

## kernel/kernel_device_modules-6.6/drivers/leds/flash/Kconfig
```kconfig
config DEVICE_MODULES_LEDS_MT6370_FLASH
	tristate "Flash LED Support for MediaTek MT6370 PMIC"
	depends on LEDS_CLASS && OF
	depends on LEDS_CLASS_FLASH || !LEDS_CLASS_FLASH
	depends on V4L2_FLASH_LED_CLASS || !V4L2_FLASH_LED_CLASS
	depends on DEVICE_MODULES_MFD_MT6370
	help
	  Support 2 channels and torch/strobe mode.
	  Say Y here to enable support for
	  MT6370_FLASH_LED device.

	  This driver can also be built as a module. If so, the module
	  will be called "leds-mt6370-flash".

config LEDS_MT6379
	tristate "Flash LED support for Mediatek MT6379 PMIC"
	depends on OF
	depends on V4L2_FLASH_LED_CLASS || !V4L2_FLASH_LED_CLASS
	depends on MFD_MT6379_I2C || MFD_MT6379_SPMI
	help
	  This option enables support Mediatek MT6379 flash LED controller.
	  MT6379 integrate charger, typec, dual BMS gauge, one general
	  Buck-Boost controller and three channels flash LED drivers. Each
	  channel support 25mA to 400mA for torch mode and 50mA to 1500mA for
	  strobe mode.

	  To compile this driver as a module, choose M here: the module
	  will be called leds-mt6379.
```

## kernel/kernel_device_modules-6.6/drivers/media/platform/mtk-vcodec/Kconfig
```kconfig
config VIDEO_MEDIATEK_VCODEC_V1
	bool "Specify Mediatek Video Vcodec Platform V1"
	help
	  Select MediaTek Video Vcodec Platform V1
	  v1 folder is dvfs setting for policy 1
	  Set Y to select this feature for specific platform-V1.
	  If unsure, set N to disable.

config VIDEO_MEDIATEK_VCODEC_V2
	bool "Specify Mediatek Video Vcodec Platform V2"
	help
	  Select MediaTek Video Vcodec Platform V2
	  v2 folder is dvfs setting for policy 2
	  Set Y to select this feature for specific platform-V2.
	  If unsure, set N to disable.

config MTK_VCODEC_DEBUG
	bool "Video Vcodec Debug support"
	help
	  This is a debug interface for Video Codec
	  Set Y to enable this feature.
	  Set N to disable this feature.
	  If unsure, Set N to disable it.
```

## kernel/kernel_device_modules-6.6/drivers/media/virtio/Kconfig
```kconfig
# SPDX-License-Identifier: GPL-2.0+
# Video driver for virtio

config VIRTIO_VIDEO
	tristate "Virtio video V4L2 driver"
	depends on VIRTIO && VIDEO_DEV
	select VIDEOBUF2_DMA_SG
	select VIDEOBUF2_DMA_CONTIG
	select V4L2_MEM2MEM_DEV
	select VIRTIO_DMA_SHARED_BUFFER
	help
          This is the virtual video driver for virtio.
          Say Y or M.

config VIRTIO_VIDEO_MTK_EXTENSION
	tristate "MTK extensions"
	depends on VIRTIO_VIDEO

config VIRTIO_VIDEO_TRACE_DEBUG
	bool "VIRTIO Video TRACE Debug support"
	depends on VIRTIO_VIDEO_MTK_EXTENSION
	help
          This is a debug interface for VIRTIO Video
          Set Y to enable this feature.
          Set N to disable this feature.
          If unsure, Set N to disable it.
```
