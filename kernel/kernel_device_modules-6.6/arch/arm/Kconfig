## kernel/kernel_device_modules-6.6/drivers/gpu/drm/panel/smcdsd_panel/Kconfig
```kconfig
if DRM_MEDIATEK_V2 && !MTK_FB

config SMCDSD_PANEL
	tristate "Samsung Mobile Communication Division System Display"
	default n

endif # DRM_MEDIATEK_V2 && !MTK_FB

source "$(KCONFIG_EXT_PREFIX)drivers/gpu/drm/panel/smcdsd_panel/panels/Kconfig"
```

## kernel/kernel_device_modules-6.6/drivers/gpu/drm/panel/smcdsd_panel/panels/Kconfig
```kconfig
if DRM_MEDIATEK_V2 && !MTK_FB && SMCDSD_PANEL

config SMCDSD_LCD_DEBUG
	bool "Support LCD_DEBUG"
	depends on DEBUG_FS && !SAMSUNG_PRODUCT_SHIP
	default n

config SMCDSD_DPUI
	bool "Support DPUI"

config SMCDSD_MDNIE
	bool "Support MDNIE"

config SMCDSD_DOZE
	bool "Support DOZE"

config SMCDSD_MASK_LAYER
	bool "Support mask layer"

config SMCDSD_DYNAMIC_MIPI
	bool "Support dynamic mipi"

config SMCDSD_PANEL_M53X
	bool "Support SMCDSD_PANEL_M53X driver"
	select SMCDSD_LCD_DEBUG
	select SMCDSD_DPUI
	select SMCDSD_MDNIE
	select SMCDSD_DOZE
	select SMCDSD_DYNAMIC_MIPI
	default n

config SMCDSD_PANEL_A34X
	bool "Support SMCDSD_PANEL_A34X driver"
	select SMCDSD_LCD_DEBUG
	select SMCDSD_DPUI
	select SMCDSD_MDNIE
	select SMCDSD_DOZE
	select SMCDSD_MASK_LAYER
	select SMCDSD_DYNAMIC_MIPI
	default n

endif # DRM_MEDIATEK_V2 && !MTK_FB && SMCDSD_PANEL
```

## kernel/kernel_device_modules-6.6/drivers/hypervisor/guest/Kconfig
```kconfig
# SPDX-License-Identifier: GPL-2.0-only
#
# Virtualization android guest support drivers
#

config GRT_VM
	tristate "hypervisor guest android1 os"
	help
	  The hypervisor project is "m".
	  Used for hypervisor guest android1 os.
	  If your code is for hypervisor android os,
	  you can use it to wrap your code.
```

## kernel/kernel_device_modules-6.6/drivers/hypervisor/host/Kconfig
```kconfig
# SPDX-License-Identifier: GPL-2.0-only
#
# Virtualization yocto host support drivers
#

config DEVICE_MODULES_ACRN_HSM
	tristate "ACRN Hypervisor Service Module"
	select EVENTFD
	help
	  ACRN Hypervisor Service Module (HSM) is a kernel module which
	  communicates with ACRN userspace through ioctls and talks to
	  the ACRN Hypervisor through hypercalls. HSM will only run in
	  a privileged management VM, called Service VM, to manage User
	  VMs and do I/O emulation. Not required for simply running
	  under ACRN as a User VM.

	  To compile as a module, choose M, the module will be called
	  acrn. If unsure, say N.

config DEVICE_MODULES_VHOST_BLK
	tristate "Host kernel accelerator for virtio blk (EXPERIMENTAL)"
	depends on BLOCK
	select VHOST
	help
	  This kernel module can be loaded in host kernel to accelerate
	  guest block with virtio_blk. Not to be confused with virtio_blk
	  module itself which needs to be loaded in guest kernel.

	  To compile this driver as a module, choose M here: the module will
	  be called vhost_blk.

config DEVICE_MODULES_VHOST_UART
	tristate "Host kernel accelerator for virtio uart (EXPERIMENTAL)"
	select VHOST
	help
	  This kernel module can be loaded in host kernel to accelerate
	  guest uart with virtio_console. Not to be confused with virtio_console
	  module itself which needs to be loaded in guest kernel.

	  To compile this driver as a module, choose M here: the module will
	  be called vhost_uart.

config VHOST_CMDQ
	tristate "hypervisor vhost cmdq driver"
	help
	  This extension enable vhost cmdq driver, vhost cmdq driver
	  for hypervisor project. The vhost driver is located at virt/grt,
	  Also used to isolate the conflicting part of the cmdq driver
	  on main project, default is n.

config VHOST_DMABUF
	tristate "vhost_dmabuf driver used to share buffers between dual systems"
	help
	  This kernel module can be loaded into the host kernel to import the
	  virtual address (va) passed by the guest and export a vhost file
	  descriptor (fd) to provide users with shared buffer capabilities.

	  To compile as a module, choose M, the module will be called
	  acrn. If unsure, say N.

config VHOST_VDMABUF
	tristate "hypervisor vhost vdmabuf driver"
	help
	  This extension enable vhost vdmabuf driver, vhost vdmabuf driver
	  for hypervisor project. The vhost driver is located at virt/grt.
	  The guest-os will share buf with host-os via buf-id. This driver
	  import the buffer from guest-os and return a dmabuf fd to userspace.
	  If unsure, say N.

config GRT_HYPERVISOR
	tristate "hypervisor driver config"
	help
	  This config enable hypervisor driver for hypervisor project, GRT_HYPERVISOR
	  can be used to distinguish hypervisor yocto OS and yocto OS. This config
	  is used in vhost OS(hypervisor yocto OS), default is n, to compile driver
	  as a module, choose M here.

config DEVICE_MODULES_VHOST_ADSP
	tristate "Host kernel accelerator for virtio blk (EXPERIMENTAL)"
	depends on BLOCK
	select VHOST
	help
	  This kernel module can be loaded in host kernel to accelerate
	  guest block with virtio_adsp. Not to be confused with virtio_adsp
	  module itself which needs to be loaded in guest kernel.

	  To compile this driver as a module, choose M here: the module will
	  be called vhost_adsp.

config VHOST_IOMMU
	tristate "hypervisor vhost iommu driver"
	help
	  This extension enable vhost iommu driver, vhost iommu driver
	  for hypervisor project. The vhost driver is located at virt/grt,
	  Also used to isolate the conflicting part of the iommu driver
	  on main project, default is n.

config VHOST_APU
       tristate "Host kernel accelerator for virtio apu (EXPERIMENTAL)"
       select VHOST
       help
         This kernel module can be loaded in host kernel to accelerate
         guest block with virtio_apu. Not to be confused with virtio_apu
         module itself which needs to be loaded in guest kernel.

         To compile this driver as a module, choose M here: the module will
         be called vhost_apu.

config DEVICE_MODULES_VHOST_SPI
	tristate "Hypervisor for virtio spi"
	select VHOST
	help
	  This kernel module can be loaded in host kernel to accelerate
	  guest block with virtio_spi. Not to be confused with virtio_spi
	  module itself which needs to be loaded in guest kernel.

	  To compile this driver as a module, choose M here: the module will
	  be called vhost_spi.

config VHOST_MMDVFS
	tristate "hypervisor vhost mmdvfs driver"
	help
	  This extension enable vhost mmdvfs driver, vhost mmdvfs driver enable
	  for hypervisor project. The vhost driver is located at virt/grt,
	  Also used to isolate the conflicting part of the mmdvfs driver
	  on main project, default is n.

config VHOST_DISP
	tristate "hypervisor vhost disp driver"
	help
	  This extension enable vhost disp driver, vhost disp driver
	  for hypervisor project. The vhost driver is located at virt/grt,
	  Also used to isolate the conflicting part of the disp driver
	  on main project, default is n.
```

## kernel/kernel_device_modules-6.6/drivers/hypervisor/nebula/Kconfig
```kconfig
#
# Nebula
#

menu "Nebula"

config NEBULA
	tristate "Nebula"
	default n
	help
	  Nebula is a secure Operating System (OS) that provides a
	  Trusted Execution Environment (TEE) for Android.
	  Nebula is compatible with ARM and Intel processors.
	  Say N if unsure.

config NEBULA_CORE
	tristate "Nebula core driver"
	depends on NEBULA
	default n
	help
	  Nebula core driver provides the basic function for other
	  Nebula drivers.
	  Nebula is compatible with ARM and Intel processors.
	  Say N if unsure.

config NEBULA_VIRQ_SIMULATION
	tristate "Nebula Virq Simulation"
	default n
	help
	  This module adds support for simulations of communications based
	  on virq with Nebula Services.
	  It'll be called trusty-ipc, trusty-virtio.
	  Say N if unsure.

config NEBULA_LOG
	tristate
	depends on NEBULA_CORE
	default y
	help
	  It is designed to enable the logging subsystem for the Nebula
	  environment. It is responsible for capturing, managing, and
	  displaying log messages generated by various components within
	  the Nebula system.
	  Logging is a critical feature for monitoring system behavior,
	  diagnosing issues, and ensuring that developers can track the
	  internal operations of the system.

config NEBULA_VIRTIO
	tristate "Nebula virtio support"
	depends on NEBULA_CORE
	select VIRTIO
	default y
	help
	  It is responsible for enabling support for the Nebula virtio
	  framework within the system.
	  The Nebula virtio support ensures that the system can work
	  efficiently with virtualized I/O devices using the virtio protocol.

config NEBULA_VIRTIO_IPC
	tristate "Nebula Virtio IPC driver"
	depends on NEBULA_VIRTIO
	default y
	help
	  This module adds support for communications with Nebula Services.
	  It is a critical component for enabling efficient communication
	  channels between different processes, specifically tailored for
	  environments that leverage the Nebula and Virtio frameworks.
	  If you choose to build a module, it'll be called trusty-ipc.
	  Say N if unsure.

config NEBULA_IPC
	tristate "Nebula IPC Kernel API"
	depends on NEBULA_VIRTIO_IPC || NEBULA_VTEE_VIRTIO_IPC
	default n
	help
	  This module adds APIs for drivers to communicate with Nebula services.
	  It is responsible for enabling the Kernel API necessary for facilitating
	  inter-process communication (IPC) with Nebula services. When enabled, it
	  allows drivers within the kernel to interact and exchange information
	  with various Nebula services.

config NEBULA_IPC_DEV_MAJOR
	int "Nebula IPC character device major number"
	depends on NEBULA_VIRTIO_IPC
	default 0
	help
	  This number will be use as the major number in registering
	  chrdev if it's NOT 0. If it's 0, the major number would be
	  chosen dynamically. Pick an valid number if it conflicts
	  with other legacy drivers.

config NEBULA_LOG_DEV_MAJOR
	int "Nebula log character device major number"
	depends on NEBULA_LOG
	default 0
	help
	  This number will be use as the major number in registering
	  chrdev if it's NOT 0. If it's 0, the major number would be
	  chosen dynamically. Pick an valid number if it conflicts
	  with other legacy drivers.

config NEBULA_RPC_DEV_MAJOR
	int "Nebula rpc character device major number"
	depends on NEBULA_RPC
	default 0
	help
	  This number will be use as the major number in registering
	  chrdev if it's NOT 0. If it's 0, the major number would be
	  chosen dynamically. Pick an valid number if it conflicts
	  with other legacy drivers.

config NEBULA_RPC
	tristate "Nebula RPC"
	depends on NEBULA_IPC
	default n
	help
	  It activates the support for Nebula's Remote Procedure Call (RPC)
	  mechanism within the kernel. This feature is designed to enable
	  structured communication between different processes, by allowing
	  them to call functions or procedures in each other's address spaces
	  as if they were local.

config NEBULA_VTEE
	tristate "Nebula Virtual TEE support (SMC forwarding mode)"
	depends on NEBULA_CORE
	default n
	help
	  It is responsible for enabling support for the Nebula Virtual Trusted
	  Execution Environment (TEE) within the kernel.
	  Nebula virtual TEE driver is used for communicating with the Nebula TEE
	  OS if the Nebula Hypervisor is enabled.
	  Say N if unsure.

config NEBULA_VTEE_LOG
	tristate "Nebula Virtual TEE log driver"
	depends on NEBULA_VTEE
	default n
	help
	  It is responsible for enabling log support for the Nebula Virtual Trusted
	  Execution Environment (TEE) within the kernel.
	  Nebula virtual TEE log driver is used for collecting Nebula vTEE OS
	  logs and print to kernel dmesg buffer.
	  Say N if unsure.

config NEBULA_VTEE_LOG_DEV_MAJOR
	int "Nebula log character device major number"
	depends on NEBULA_VTEE_LOG
	default 0
	help
	  This number will be use as the major number in registering
	  chrdev if it's NOT 0. If it's 0, the major number would be
	  chosen dynamically. Pick an valid number if it conflicts
	  with other legacy drivers.

choice
	prompt "Platform flavor"
	default NEBULA_HAL_GENERIC
	help
	  It presents a selection of mutually exclusive options to the user,
	  typically representing different hardware platform support within
	  the Nebula system.
	  The default option is NEBULA_HAL_GENERIC.

config NEBULA_HAL_GENERIC
	bool "GENERIC"
	help
	  Generic HAL implementation.
	  It enables the inclusion of a generic Hardware Abstraction Layer (HAL)
	  implementation within the Nebula system.
	  This option, when selected, provides a standard interface between the
	  operating system and the hardware of the computer system.

config NEBULA_HAL_MEDIATEK
	bool "Mediatek"
	help
	  Supporting for Mediatek platform.
	  It is designed to enable support for the Mediatek platform within the
	  Nebula system's Hardware Abstraction Layer (HAL).
	  This option, when selected, provides a Mediatek interface between the
	  operating system and the hardware of the computer system.

endchoice

endmenu
```

## kernel/kernel_device_modules-6.6/drivers/i3c/master/Kconfig
```kconfig
# SPDX-License-Identifier: GPL-2.0-only

config DEVICE_MODULES_MTK_I3C_MASTER_MT69XX
	tristate "MTK I3C master mt69xx driver"
	depends on ARCH_MEDIATEK || COMPILE_TEST
	depends on I3C
	depends on HAS_IOMEM
	depends on !(ALPHA || PARISC)
	help
	  This selects the Mediatek(R) I3C master bus driver
	  for MT69XX.
	  If you want to use Mediatek(R) I3C interface, say Y or M here.
	  If unsure, say N.
```

## kernel/kernel_device_modules-6.6/drivers/input/touchscreen/BoTai_Multi_Touch/Kconfig
```kconfig
config TOUCHSCREEN_BOTAI_TOUCH_ONE
	tristate "GT9XX_ONE touchscreen"
	help
	  Say Y here if you have a GT9XX
	  to your system.
	  If build module, say M.
	  If unsure, say N.

config TOUCHSCREEN_BOTAI_TOUCH_TWO
	tristate "GT9XX_TWO touchscreen"
	help
	  Say Y here if you have a GT9XX
	  to your system.
	  If build module, say M.
	  If unsure, say N.

config TOUCHSCREEN_BOTAI_TOUCH_THREE
	tristate "GT9XX_THREE touchscreen"
	help
	  Say Y here if you have a GT9XX
	  to your system.
	  If build module, say M.
	  If unsure, say N.

config TOUCHSCREEN_BOTAI_TOUCH_FOUR
	tristate "GT9XX_FOUR touchscreen"
	help
	  Say Y here if you have a GT9XX
	  to your system.
	  If build module, say M.
	  If unsure, say N.

config TOUCHSCREEN_BOTAI_TOUCH_FIVE
	tristate "GT9XX_FIVE touchscreen"
	help
	  Say Y here if you have a GT9XX
	  to your system.
	  If build module, say M.
	  If unsure, say N.

config TOUCHSCREEN_BOTAI_TOUCH_SIX
	tristate "GT9XX_SIX touchscreen"
	help
	  Say Y here if you have a GT9XX
	  to your system.
	  If build module, say M.
	  If unsure, say N.
```

## kernel/kernel_device_modules-6.6/drivers/input/touchscreen/ILITEK/Kconfig
```kconfig
menuconfig TOUCHSCREEN_ILITEK
	tristate "ilitek touchscreen"
	help
	  Say Y here if you have a ilitek
	  to your system.
	  If build module, say M.
	  If unsure, say N.
```
