## kernel/kernel_device_modules-6.6/arch/arm/Kconfig
```kconfig
# SPDX-License-Identifier: GPL-2.0-only

config MTK_ARM
	bool "MTK_ARM config"
	select ARM_GIC_V3
	select ARM_PSCI
	select POWER_RESET
	select MEDIA_SUPPORT
	select PAGE_REPORTING
	select PINCTRL_SINGLE
	select IOMMU_IO_PGTABLE_LPAE
	select RESET_SIMPLE
	select GENERIC_PHY_MIPI_DPHY
	select RAS
	select TRACE_GPU_MEM
	select GENERIC_IRQ_CHIP
	select IRQ_FASTEOI_HIERARCHY_HANDLERS
	select ARCH_SUPPORTS_BIG_ENDIAN
	select MEMORY_BALLOON
	select BALLOON_COMPACTION
	select MMU_NOTIFIER
	select HMM_MIRROR
	select WEXT_SPY
	select SYS_HYPERVISOR
	select HAVE_IDE
	select GPIOLIB_IRQCHIP
	select CEC_CORE
	select CEC_NOTIFIER
	select CEC_PIN
	select MEDIA_CEC_RC
	select MEDIA_CONTROLLER_REQUEST_API
	select DRM_TTM
	select DRM_KMS_CMA_HELPER
	select DRM_GEM_SHMEM_HELPER
	select SND_PCM_ELD
	select SND_PCM_IEC958
	select SND_DMAENGINE_PCM
	select SND_COMPRESS_OFFLOAD
	select SND_VMASTER
	select SND_SOC_GENERIC_DMAENGINE_PCM
	select SND_SOC_COMPRESS
	select SND_SOC_TOPOLOGY
	select MMC_SDHCI_IO_ACCESSORS
	select ARCH_HAS_RESET_CONTROLLER
	select CRYPTO_ENGINE
	select CRYPTO_DEV_ALLWINNER
	select INTERVAL_TREE
	select EDAC
	select EDAC_LEGACY_SYSFS
	select ARM_GIC
	select GENERIC_CLOCKEVENTS
	select ARM_AMBA
	select IRQ_DOMAIN
	select GENERIC_SCHED_CLOCK
	select CPU_IDLE
	select NEON
	select VFP
	select KERNEL_MODE_NEON
	select PINCTRL
	select HAVE_ARM_ARCH_TIMER
	select PHYLIB
	select DMADEVICES
	select WIRELESS_EXT
	select NET_PTP_CLASSIFY
	select WEXT_PRIV
	select PAGE_POOL
	select PHYLINK
	select GENERIC_PINCTRL_GROUPS
	select GENERIC_PINMUX_FUNCTIONS
	# Above selects are sorted alphabetically; please add new ones
	# according to that.  Thanks.
	help
	  The ARM series is a line of low-power-consumption RISC chip designs
	  licensed by ARM Ltd and targeted at embedded applications and
	  handhelds such as the Compaq IPAQ.  ARM-based PCs are no longer
	  manufactured, but legacy ARM-based PC hardware remains popular in
	  Europe.  There is an ARM Linux project with a web page at
	  <http://www.arm.linux.org.uk/>.
```

## kernel/kernel_device_modules-6.6/arch/arm64/configs/a34x_00_defconfig
```kconfig
CONFIG_CUSTOM_KERNEL_IMGSENSOR="imx582_mipi_raw imx258_mipi_raw s5k4hayx_mipi_raw gc5035_mipi_raw sr846d_mipi_raw hi1339_mipi_raw"
CONFIG_IMGSENSOR_CUSTOM_CAMERA=y
CONFIG_CAMERA_AAW_V34X=y
CONFIG_CAMERA_SAMSUNG_MODEL_NAME="aaw_v34x"
CONFIG_CAMERA_SENSOR0="imx582_mipi_raw"
CONFIG_CAMERA_SENSOR1="imx258_mipi_raw"
CONFIG_CAMERA_SENSOR1_2="hi1339_mipi_raw"
CONFIG_CAMERA_SENSOR2="s5k4hayx_mipi_raw"
CONFIG_CAMERA_SENSOR2_2="sr846d_mipi_raw"
CONFIG_CAMERA_SENSOR3="gc5035_mipi_raw"
CONFIG_IMGSENSOR_SYSFS=y
CONFIG_CAMERA_ADAPTIVE_MIPI=y
CONFIG_CAMERA_OIS=y
CONFIG_DEVICE_MODULES_LEDS_MT6360=m
# CONFIG_SND_SOC_RT5512 is not set
# CONFIG_SND_SOC_TFA9874 is not set
CONFIG_SND_SOC_TFA9878=m
CONFIG_TFA_STEREO_NODE=y
CONFIG_PLATFORM_MTK=y
CONFIG_SND_SOC_SAMSUNG_AUDIO=m
CONFIG_SMCDSD_PANEL=m
CONFIG_SMCDSD_PANEL_A34X=y
CONFIG_MTK_VOW_SUPPORT=m
CONFIG_MTK_VOW_DSP_VERSION="ver02"
# CONFIG_MTK_VOW_DUAL_MIC_SUPPORT is not set
CONFIG_MTK_VOW_MAX_PDK_NUMBER=0
CONFIG_SHUB_AOIS=y
CONFIG_SHUB_DUMP_NOTI=y
CONFIG_SAMSUNG_TUI=m
CONFIG_SAMSUNG_TUI_LOWLEVEL=y
CONFIG_MTK_NO_BAT_BOOT_SUPPORT=y
# CONFIG_MTK_CHGLOG_SUPPORT is not set
CONFIG_CPU_FREQ_LTL_LIMIT=y
CONFIG_SEC_DEBUG_DUMP_SINK=y
CONFIG_SEC_DEBUG_MT6877=y
CONFIG_MTK_PRIO_TASK_CONTROL=y
CONFIG_SEC_WAKEUP_CPU_ALLOCATOR=m
# CONFIG_RODATA_FULL_DEFAULT_ENABLED is not set
# CONFIG_ARM64_E0PD is not set
```

## kernel/kernel_device_modules-6.6/arch/arm64/configs/lego_defconfig
```kconfig
CONFIG_VIBRATOR_VIB_INFO=m
CONFIG_SEC_NFC_LOGGER=y
# CONFIG_NFC_LOGGER_LOWMEM is not set
CONFIG_DEV_RIL_BRIDGE=m
CONFIG_SEC_VIBRATOR=m
CONFIG_SEC_MTK_CHARGER=m
CONFIG_MUIC_NOTIFIER=m
CONFIG_HICCUP_CHARGER=y
CONFIG_MUIC_COMMON_SYSFS=y
CONFIG_MUIC_AFC_RETRY=y
CONFIG_MUIC_HV=y
CONFIG_MUIC_SUPPORT_PDIC=y
CONFIG_MUIC_USE_MODULE_PARAM=y
CONFIG_USE_MUIC=y
CONFIG_NGKSM=m
CONFIG_NGKPAD=m
CONFIG_NGKSM_MTK=y
CONFIG_SEC_STI=y
CONFIG_USB_NOTIFY_LAYER=m
CONFIG_USB_DEBUG_DETAILED_LOG=y
CONFIG_USB_EXTERNAL_NOTIFY=y
CONFIG_USB_HMT_SAMSUNG_INPUT=y
CONFIG_USB_HOST_NOTIFY=y
CONFIG_USB_HOST_SAMSUNG_FEATURE=y
CONFIG_USB_HW_PARAM=y
CONFIG_USB_INTERFACE_LPM_LIST=y
CONFIG_USB_NOTIFY_PROC_LOG=y
CONFIG_USB_USING_ADVANCED_USBLOG=y
CONFIG_SEC_INPUT_BOOSTER=m
CONFIG_SEC_INPUT_BOOSTER_MODE=y
CONFIG_SEC_INPUT_BOOSTER_MTK=y
CONFIG_SEC_INPUT_BOOSTER_HANDLER=y
CONFIG_SB_CORE=m
CONFIG_SB_PQUEUE=y
CONFIG_SB_NOTIFY=y
CONFIG_SB_SYSFS=y
CONFIG_SB_VOTE=y
CONFIG_HDM=m
CONFIG_HDM_MTK=y
CONFIG_INPUT_SEC_INPUT=m
CONFIG_SEC_DEBUG_TSP_LOG=m
# CONFIG_INPUT_SEC_SECURE_TOUCH is not set
CONFIG_TOUCHSCREEN_DUMP_MODE=m
# CONFIG_INPUT_TOUCHSCREEN_TCLMV2 is not set
# CONFIG_TOUCHSCREEN_DUAL_FOLDABLE is not set
CONFIG_INPUT_SEC_NOTIFIER=m
CONFIG_VBUS_NOTIFIER=m
CONFIG_USB_TYPEC_MANAGER_NOTIFIER=m
CONFIG_IF_CB_MANAGER=m
CONFIG_SENSORS_FINGERPRINT=m
CONFIG_KZT=m
CONFIG_FUELGAUGE_MTK=m
CONFIG_SEC_ABC_SPEC_TYPE1=m
CONFIG_PDIC_NOTIFIER=m
CONFIG_PDIC_USE_MODULE_PARAM=y
CONFIG_VIRTUAL_MUIC=m
CONFIG_SEC_ABC=m
CONFIG_SEC_ABC_HUB=m
CONFIG_SEC_ABC_COMMON=m
CONFIG_SEC_ABC_HUB_CORE=m
CONFIG_SEC_ABC_HUB_BOOTC=m
CONFIG_SEC_ABC_MOTTO=m
CONFIG_USB_NOTIFIER=m
CONFIG_I2C_GPIO=m
CONFIG_CHARGER_SM5451=m
CONFIG_SEC_PM_THERMISTOR=m
CONFIG_ISA1000_VIBRATOR=m
CONFIG_INPUT_HALL_IC=m
CONFIG_HALL_NOTIFIER=m
CONFIG_HALL_LOGICAL=m
# CONFIG_HALL_DUMP_KEY_MODE is not set
CONFIG_SENSORS_EL7XX=m
CONFIG_SENSORS_FINGERPRINT_MODULE=y
CONFIG_FINGERPRINT_SECURE=y
CONFIG_SENSORS_FINGERPRINT_MTK=y
CONFIG_MST_LDO=m
CONFIG_MST_ARCH_MTK=y
CONFIG_MST_TEEGRIS=y
CONFIG_MST_DUMMY_DRV=y
CONFIG_AFC_CHARGER=m
CONFIG_SHUB_MODULE=y
CONFIG_SHUB_PM_WAKEUP_LINUX_VER_5_4=y
CONFIG_SHUB_AP_STATUS_CMD=y
CONFIG_SHUB_MTK=y
CONFIG_SHUB_MTK_SCP_INCLUDE=y
# CONFIG_SHUB_FIRMWARE_DOWNLOAD is not set
CONFIG_REGULATOR_S2MPB03=m
CONFIG_DIRECT_CHARGING=m
CONFIG_IIO=y
CONFIG_IIO_BUFFER=y
CONFIG_SHUB=m
CONFIG_SAMSUNG_NFC=m
CONFIG_SEC_MX_NFC=y
CONFIG_MTK_NFC_CLKBUF_ENABLE=y
CONFIG_MTK_CLKBUF_NFC=y
# CONFIG_SEC_NFC_EINT_EXYNOS is not set
CONFIG_SEC_NFC_WAKELOCK_METHOD=2
# CONFIG_SEC_NFC_DUPLICATED_IRQ_WQ is not set
# CONFIG_SEC_NFC_TEST_ON_PROBE is not set
# CONFIG_ESE_P3_LSI is not set
# CONFIG_ESE_COLDRESET is not set
# CONFIG_ESE_USE_REGULATOR is not set
# CONFIG_MAKE_NODE_USING_PLATFORM_DEVICE is not set
CONFIG_TOUCHSCREEN_GOODIX_BRL=m
CONFIG_SENSORS_SUPPORT_MTK=y
CONFIG_SENSORS_ISG5320A=m
CONFIG_SENSORS_ISG5320A_SUB=y
# CONFIG_TEST_FOR_GRIP is not set
# CONFIG_SENSORS_CORE_AP is not set
# CONFIG_SENSORS_GRIP_FAILURE_DEBUG is not set
CONFIG_BATTERY_SAMSUNG=m
CONFIG_SEC_PD=m
CONFIG_BATTERY_GKI=y
CONFIG_BATTERY_AGE_FORECAST=y
CONFIG_BATTERY_CISD=y
CONFIG_AFC_CHARGER_MODE=y
CONFIG_BATTERY_LOGGING=y
CONFIG_ENABLE_FULL_BY_SOC=y
CONFIG_STEP_CHARGING=y
CONFIG_SUPPORT_HV_CTRL=y
CONFIG_USB_FACTORY_MODE=y
```

## kernel/kernel_device_modules-6.6/drivers/clocksource/Kconfig
```kconfig
# SPDX-License-Identifier: GPL-2.0-only
menu "Clock Source drivers"
	depends on GENERIC_CLOCKEVENTS

config DEVICE_MODULES_MTK_TIMER
	tristate "Mediatek timer driver"
	depends on HAS_IOMEM
	select TIMER_OF
	select CLKSRC_MMIO
	help
	  Support for Mediatek timer driver.

endmenu

config MEDIATEK_ERRATUM_690001
	bool "Workaround for MediaTek MT69XX erratum 690001"
	depends on ARM_ARCH_TIMER && ARM64
	help
	  This option enables a workaround for incomplete implementation
	  in the MMIO timer on the MediaTek MT69XX SoCs. The workaround
	  will only be active if mediatek,erratum-690001 property is
	  found in the timer node.
```

## kernel/kernel_device_modules-6.6/drivers/dma-buf/heaps/Kconfig
```kconfig
config DEVICE_MODULES_DMABUF_HEAPS_DEFERRED_FREE
	tristate "DMA-BUF heaps deferred-free library"
	help
	  Choose this option to enable the DMA-BUF heaps deferred-free library.

config DEVICE_MODULES_DMABUF_HEAPS_PAGE_POOL
	tristate "DMA-BUF heaps page-pool library"
	help
	  Choose this option to enable the DMA-BUF heaps page-pool library.

config DEVICE_MODULES_DMABUF_HEAPS_SYSTEM
	tristate "DMA-BUF System Heap"
	depends on DMABUF_HEAPS
	help
	  Choose this option to enable the system dmabuf heap. The system heap
	  is backed by pages from the buddy allocator. If in doubt, say Y.

config DEVICE_MODULES_DMABUF_HEAPS_REFILL
	tristate "DMA-BUF heap refill"
	depends on DEVICE_MODULES_DMABUF_HEAPS_SYSTEM
	help
	  Choose this option to enable heap refill. Pool has high water and low
	  water. After executing dmabuf alloc and detecting that the current pool
	  size is lower than the low water, the refill thread is started. The
	  refill worker thread allocates pages to fill in the pool, and stops
	  filling when the pool size is higher than the high water mark.

config DMABUF_HEAPS_DEBUG
	tristate "DMA-BUF debug Heap"
	depends on DEVICE_MODULES_DMABUF_HEAPS_SYSTEM
	help
	  Choose this option to enable the mtk debug heap.
	  This debug tool can be use to dump dmabuf usage for users
	  If you want use it, say Y if you are not using GKI
	  say m and add ko into your system for GKI.

config DMABUF_LEGACY_TEST
	tristate "DMA-BUF test legacy"
	help
	  Choose this option to skip dmabuf secure test.
	  This config is for legacy chip to skip new chip only case.
	  If you are sure the chip not support the dmabuf secure test, say Y to
	  skip the case. If in doubt, say N.

config RBIN
	bool "DMA-BUF RBIN Samsung Heap"
	depends on DMABUF_HEAPS && CLEANCACHE
	default y
	help
	  Choose this option to enable dma-buf rbin heap for samsung.
```

## kernel/kernel_device_modules-6.6/drivers/firmware/cirrus/Kconfig
```kconfig
# SPDX-License-Identifier: GPL-2.0-only

config DEVICE_MODULES_FW_CS_DSP
	tristate
	default n
```

## kernel/kernel_device_modules-6.6/drivers/gpu/drm/bridge/Kconfig
```kconfig
# SPDX-License-Identifier: GPL-2.0-only
config DRM_SERDES_DP
	tristate "DRM Serdes DP Support for Platform SoCs"
	depends on OF
	select SERDES_DP
	help
	  Enable support for the Serdes-based DisplayPort (DP) interface
	  on Mediatek SoCs. This driver provides the necessary functionality
	  to initialize and manage the Serdes hardware that handles the
	  high-speed data lanes used for DisplayPort connections on these
	  platforms. Enabling this option will allow the DRM subsystem to
	  communicate with DisplayPort devices via the Serdes interface.
```

## kernel/kernel_device_modules-6.6/drivers/gpu/drm/mediatek/Kconfig
```kconfig
# SPDX-License-Identifier: GPL-2.0-only
config DEVICE_MODULES_DRM_MEDIATEK
	tristate "DRM Support for Mediatek SoCs"
	depends on DRM
	depends on ARCH_MEDIATEK || (ARM && COMPILE_TEST)
	depends on COMMON_CLK
	depends on HAVE_ARM_SMCCC
	depends on OF
	depends on DEVICE_MODULES_MTK_MMSYS
	select DRM_DISPLAY_DP_HELPER
	select DRM_DISPLAY_HELPER
	select DRM_GEM_DMA_HELPER
	select DRM_KMS_HELPER
	select DRM_MIPI_DSI
	select DRM_PANEL
	select MEMORY
	select DEVICE_MODULES_MTK_SMI
#	select PHY_MTK_MIPI_DSI
	select VIDEOMODE_HELPERS
	help
	  Choose this option if you have a Mediatek SoCs.
	  The module will be called mediatek-drm
	  This driver provides kernel mode setting and
	  buffer management to userspace.

config DRM_MEDIATEK_CEC
	tristate "DRM CEC Support for Mediatek SoCs"
	help
	  DRM/KMS HDMI CEC driver for Mediatek SoCs.
	  Choose this option if you want to enable
	  CEC driver, and the DRM_MEDIATEK_HDMI
	  selects this config.

config DRM_MEDIATEK_CEC_SUSPEND_LOW_POWER
	tristate "DRM CEC SUSPEND LOW POWER Support for Mediatek SoCs"
	help
      This option enables support for DRM/KMS CEC
	  SUSPEND_LOW_POWER for Mediatek SoCs. When
	  this option is enabled, the CEC clock will
	  be disabled when the platform enters suspend
	  mode, reducing power consumption during suspend.

config DRM_MEDIATEK_HDMI
	tristate "DRM HDMI Support for Mediatek SoCs"
	depends on DEVICE_MODULES_DRM_MEDIATEK
	select SND_SOC_HDMI_CODEC if SND_SOC
	select DRM_MEDIATEK_CEC
	help
	  DRM/KMS HDMI driver for Mediatek SoCs.
	  Choose this option if you want to enable
	  HDMI driver. This option enables the DRM/KMS
	  HDMI driver for Mediatek SoCs, providing
	  support for HDMI on Mediatek platforms.

config DRM_MEDIATEK_HDMI_HDCP
	tristate "DRM HDMI HDCP Support for Mediatek SoCs"
	depends on OPTEE
	depends on DRM_MEDIATEK_HDMI
	help
	  DRM/KMS HDMI HDCP driver for Mediatek SoCs.
	  Choose this option if you want to enable
	  HDMI HDCP driver. This option enables the
	  DRM/KMS HDCP driver for Mediatek SoCs, providing
	  support for HDCP for Mediatek platforms.

source "$(KCONFIG_EXT_PREFIX)drivers/gpu/drm/mediatek/mediatek_v2/Kconfig"
source "$(KCONFIG_EXT_PREFIX)drivers/gpu/drm/mediatek/mml/Kconfig"
source "$(KCONFIG_EXT_PREFIX)drivers/gpu/drm/mediatek/dummy_drm/Kconfig"
source "$(KCONFIG_EXT_PREFIX)drivers/gpu/drm/mediatek/dpc/Kconfig"
```

## kernel/kernel_device_modules-6.6/drivers/gpu/drm/mediatek/mediatek_v2/mtk_drm_edp/Kconfig
```kconfig
config DRM_MEDIATEK_EDPTX_AUTO_SUPPORT
	tristate "DRM EDP Support for Mediatek SoCs"
	depends on DEVICE_MODULES_DRM_MEDIATEK
	select PHY_MTK_EDP
	help
	  DRM/KMS EDPTX driver for Mediatek SoCs
	  Choose this option if you want to enable
	  eDPTX driver, and this config depends on
	  DRM_MEDIATEK.
```
