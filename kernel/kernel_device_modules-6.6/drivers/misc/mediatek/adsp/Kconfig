## kernel/kernel_device_modules-6.6/drivers/misc/mediatek/dcm/Kconfig
```kconfig
config MTK_DCM_COMMON
	tristate "Mediatek DCM COMMON"
	depends on ARCH_MEDIATEK && OF
	help
	  For Mediatek Dynamic Clock Management control. Provid a common interface to
	  adjust dcm setting. Setting will not keep after reboot
	  Select "y" if you want to use.
	  Select "n" if you are not sure.

config MTK_DCM_MT6761
	tristate "Mediatek MT6761 DCM control"
	depends on ARCH_MEDIATEK && OF
	select MTK_DCM_COMMON
	help
	  For Mediatek MT6761 Dynamic Clock Management HW control. Only enable when you
	  neet to change mt6761 dcm setting. Setting will not keep after reboot
	  Select "y" if you want to change mt6761 dcm setting.
	  Select "n" if you do not need to change

config MTK_DCM_MT6765
	tristate "Mediatek MT6765 DCM control"
	depends on ARCH_MEDIATEK && OF
	select MTK_DCM_COMMON
	help
	  For Mediatek MT6765 Dynamic Clock Management HW control. Only enable when you
	  neet to change mt6765 dcm setting. Setting will not keep after reboot
	  Select "y" if you want to change mt6893 dcm setting.
	  Select "n" if you do not need to change

config MTK_DCM_MT6768
	tristate "Mediatek MT6768 DCM control"
	depends on ARCH_MEDIATEK && OF
	select MTK_DCM_COMMON
	help
	  For Mediatek MT6768 Dynamic Clock Management HW control. Only enable when you
	  neet to change mt6768 dcm setting. Setting will not keep after reboot
	  Select "y" if you want to change mt6768 dcm setting.
	  Select "n" if you do not need to change

config MTK_DCM_MT6781
	tristate "Mediatek MT6781 DCM control"
	depends on ARCH_MEDIATEK && OF
	select MTK_DCM_COMMON
	help
	  For Mediatek MT6781 Dynamic Clock Management HW control. Only enable when you
	  neet to change mt6781 dcm setting. Setting will not keep after reboot
	  Select "y" if you want to change mt6781 dcm setting.
	  Select "n" if you do not need to change

config MTK_DCM_MT6833
	tristate "Mediatek MT6833 DCM control"
	depends on ARCH_MEDIATEK && OF
	select MTK_DCM_COMMON
	help
	  For Mediatek MT6833 Dynamic Clock Management HW control. Only enable when you
	  neet to change mt6833 dcm setting. Setting will not keep after reboot
	  Select "y" if you want to change mt6877 dcm setting.
	  Select "n" if you do not need to change

config MTK_DCM_MT6853
	tristate "Mediatek MT6853 DCM control"
	depends on ARCH_MEDIATEK && OF
	select MTK_DCM_COMMON
	help
	  For Mediatek MT6853 Dynamic Clock Management HW control. Only enable when you
	  neet to change mt6853 dcm setting. Setting will not keep after reboot
	  Select "y" if you want to change mt6853 dcm setting.
	  Select "n" if you do not need to change

config MTK_DCM_MT6877
	tristate "Mediatek MT6877 DCM control"
	depends on ARCH_MEDIATEK && OF
	select MTK_DCM_COMMON
	help
	  For Mediatek MT6877 Dynamic Clock Management HW control. Only enable when you
	  neet to change mt6877 dcm setting. Setting will not keep after reboot
	  Select "y" if you want to change mt6877 dcm setting.
	  Select "n" if you do not need to change

config MTK_DCM_MT6885
	tristate "Mediatek MT6885 DCM control"
	depends on ARCH_MEDIATEK && OF
	select MTK_DCM_COMMON
	help
	  For Mediatek MT6885 Dynamic Clock Management HW control. Only enable when you
	  neet to change mt6885 dcm setting. Setting will not keep after reboot
	  Select "y" if you want to change mt6893 dcm setting.
	  Select "n" if you do not need to change

config MTK_DCM_MT6985
	tristate "Mediatek MT6985 DCM control"
	depends on ARCH_MEDIATEK && OF
	select MTK_DCM_COMMON
	help
	  For Mediatek MT6985 Dynamic Clock Management HW control. Only enable when you
	  neet to change mt6985 dcm setting. Setting will not keep after reboot
	  Select "y" if you want to change mt6985 dcm setting.
	  Select "n" if you do not need to change

config MTK_DCM_MT6878
	tristate "Mediatek MT6878 DCM control"
	depends on ARCH_MEDIATEK && OF
	select MTK_DCM_COMMON
	help
	  For Mediatek MT6878 Dynamic Clock Management HW control. Only enable when you
	  neet to change mt6878 dcm setting. Setting will not keep after reboot
	  Select "y" if you want to change mt6878 dcm setting.
	  Select "n" if you do not need to change

config MTK_DCM_MT6897
	tristate "Mediatek MT6897 DCM control"
	depends on ARCH_MEDIATEK && OF
	select MTK_DCM_COMMON
	help
	  For Mediatek MT6897 Dynamic Clock Management HW control. Only enable when you
	  neet to change mt6897 dcm setting. Setting will not keep after reboot
	  Select "y" if you want to change mt6897 dcm setting.
	  Select "n" if you do not need to change


config MTK_DCM_MT6899
	tristate "Mediatek MT6899 DCM control"
	depends on ARCH_MEDIATEK && OF
	select MTK_DCM_COMMON
	help
	  For Mediatek MT6899 Dynamic Clock Management HW control. Only enable when you
	  neet to change mt6899 dcm setting. Setting will not keep after reboot
	  Select "y" if you want to change mt6899 dcm setting.
	  Select "n" if you do not need to change

config MTK_DCM_MT6989
	tristate "Mediatek MT6989 DCM control"
	depends on ARCH_MEDIATEK && OF
	select MTK_DCM_COMMON
	help
	  For Mediatek MT6989 Dynamic Clock Management HW control. Only enable when you
	  neet to change mt6989 dcm setting. Setting will not keep after reboot
	  Select "y" if you want to change mt6989 dcm setting.
	  Select "n" if you do not need to change

config MTK_DCM_MT6991
	tristate "Mediatek MT6991 DCM control"
	depends on ARCH_MEDIATEK && OF
	select MTK_DCM_COMMON
	help
	  For Mediatek MT6991 Dynamic Clock Management HW control. Only enable when you
	  neet to change mt6991 dcm setting. Setting will not keep after reboot
	  Select "y" if you want to change mt6991 dcm setting.
	  Select "n" if you do not need to change
```

## kernel/kernel_device_modules-6.6/drivers/misc/mediatek/dvfsrc/Kconfig
```kconfig
config MTK_DVFSRC_HELPER
	tristate "MTK DVFSRC Helper debugging Support"
	depends on MTK_DVFSRC
	help
	  This kernel config can be used to debug dvfsrc (dynamic voltage
	  and frequency scaling resource collector) for Mediatek vcore_dvfs.
	  When enable this option, we can trace the control flow for dvfsrc
	  and dump current vcore and dram information.
	  If unsure, say N.

config MTK_DVFSRC_MET
	tristate "MTK DVFSRC MET Support"
	depends on MTK_DVFSRC_HELPER
	help
	  This kernel config can be used to enable VCORE_DVFS info report to for MET.
	  When enable this option, it support reporting current vcore dvfs info to
	  MET system for performance and power tuning.
	  If unsure, say N.

config MTK_DVFSRC_MET_MT6873
	tristate "MTK DVFSRC MET for MT6873"
	select MTK_DVFSRC_MET
	help
	  This kernel config can be used to enable MT6873 DVFSRC MET support.
	  When enable this option, it support reporting current vcore dvfs info to
	  MET system for performance and power tuning.
	  If unsure, say N.

config MTK_DVFSRC_MB
	tristate "MTK DVFSRC MB Support"
	depends on MTK_DVFSRC_HELPER
	help
	  This kernel config can be used to enable DVFSRC MB support.
	  When enable this option, it support reporting current vcore dvfs info to
	  MB system.
	  If unsure, say N.


config MTK_DVFSRC_MET_MT6768
	tristate "MTK DVFSRC MET for MT6768"
	select MTK_DVFSRC_MET
	help
	  This kernel config can be used to enable MT6768 DVFSRC MET support.
	  When enable this option, it support reporting current vcore dvfs info to
	  MET system for performance and power tuning.
	  If unsure, say N.

config MTK_DVFSRC_MET_MT6765
	tristate "MTK DVFSRC MET for MT6765"
	select MTK_DVFSRC_MET
	help
	  This kernel config can be used to enable MT6765 DVFSRC MET support.
	  When enable this option, it support reporting current vcore dvfs info to
	  MET system for performance and power tuning.
	  If unsure, say N.

config MTK_DVFSRC_MET_MT6761
	tristate "MTK DVFSRC MET for MT6761"
	select MTK_DVFSRC_MET
	help
	  This kernel config can be used to enable MT6765 DVFSRC MET support.
	  When enable this option, it support reporting current vcore dvfs info to
	  MET system for performance and power tuning.
	  If unsure, say N.

config MTK_DVFSRC_LEGACY
	bool "MTK DVFSRC for LEGACY CHIP"
	help
	  This kernel config can be used to enable LEGACY DVFSRC support.
	  When enable this option, it support compatibility with MTK legacy chip.
	  If unsure, say N.

config MTK_DVFSRC_MT6873_IP
	tristate "MTK DVFSRC for MT6873 IP"
	help
	  Enable DVFSRC support for the MT6873 IP core.
          This feature dynamically adjusts voltage and frequency for optimal power
          and performance.
          Recommended for systems using the MT6873 IP core;
          If unsure, say N.

config MTK_DVFSRC_DEBUGFS
	tristate "MTK DVFSRC DEBUGFS Support"
	depends on MTK_DVFSRC_HELPER
	help
	  This kernel config can be used to debug dvfsrc (dynamic voltage
	  and frequency scaling resource collector) for Mediatek vcore_dvfs.
	  When enable this option, we can use dvfsrc debug.
	  If unsure, say N.
```

## kernel/kernel_device_modules-6.6/drivers/misc/mediatek/eem_v2/Kconfig
```kconfig
config MTK_PTPOD_LEGACY
	tristate "MediaTek Performance Thermal Power OverDrive for legacy chip"
	help
	  This driver calculate the minimum voltage of specified frequency
	  by efuse data and get the temperature from thermal to make up the voltage.
	  Select "y" if you want to enable this features.
	  Select "n" if unsure.

config MTK_PTPOD_ENG_DEBUG
	bool "Enable certain PTPOD debug nodes for eng build"
	depends on MTK_PTPOD_LEGACY
	help
		Certain debug nodes are intended for engineering builds (eng load) only.
                Enabling them in userdebug or user builds may pose security risks.
		Therefore, it is recommended to enable this option only in eng builds.
		Select "y" if you want to enable these features.
		Select "n" if unsure.
```

## kernel/kernel_device_modules-6.6/drivers/misc/mediatek/i3c_i2c_wrap/Kconfig
```kconfig
# SPDX-License-Identifier: GPL-2.0-only
config MTK_I3C_I2C_WRAP
	tristate "MTK I3C I2C WRAP driver"
	depends on ARCH_MEDIATEK || COMPILE_TEST
	depends on I3C
	depends on I2C
	help
	  Enable this driver if you want to support
	  MTK I3C I2C WRAP block.
	  If you want to use mtk i3c i2c wrap, say Y or M here.
	  If unsure, say N.
```

## kernel/kernel_device_modules-6.6/drivers/misc/mediatek/imgsensor/src/common/adaptive_mipi/Kconfig
```kconfig
config CAMERA_ADAPTIVE_MIPI
	bool "Camera adaptive mipi"
	default n
	help
	  If CAMERA_ADAPTIVE_MIPI is y, then "imgsensor/src/common/adaptive-mipi/" is built.
	  This is for camera bringup without Adaptive MIPI.
	  Set this config to n, while bringup the camera.config CONFIG_CAMERA_ADAPTIVE_MIPI.

config CAMERA_ADAPTIVE_MIPI_V2
	bool "Camera adaptive mipi_v2"
	default n
	help
	  If CAMERA_ADAPTIVE_MIPI_V2 is y,
	  then "vendor/mediatek/kernel_modules/mtkcam/imgsensor/common/adaptive-mipi/" is built.
	  This is for camera bringup without adaptive-mipi implementation.
	  Set this config to n, while bringup the camera.
```

## kernel/kernel_device_modules-6.6/drivers/misc/mediatek/ktchbst/Kconfig
```kconfig
config MTK_KTCHBST
	tristate "MTK Kernel Touch Boost"
	help
	  MTK Kernel Touch Boost feature.
	  The feature improves user experience. When the device receives
	  touch events, it will raise system resource like CPU frequency
	  for better user experience.
```

## kernel/kernel_device_modules-6.6/drivers/misc/mediatek/log_store/Kconfig
```kconfig
config MTK_DRAM_LOG_STORE
	tristate "mtk DRAM log store"
	help
	  DRAM log store featuer is used to store log(preload, lk) in DRAM,
	  which can be readed in kernel phase.
	  you should set in project configure file.
	  it will use SRAM buff.

config MTK_DRAM_LOG_STORE_ADDR
	hex "DRAM log store address(use SRAM)"
	default 0
	depends on MTK_DRAM_LOG_STORE
	help
	  store the SRAM address of log header information.
	  it will store the log header information.
	  the address should equal with preloader and lk setting.
	  the address behind in ramconsole.

config MTK_DRAM_LOG_STORE_SIZE
	hex "DRAM log store size(use SRAM)"
	default 0
	depends on MTK_DRAM_LOG_STORE
	help
	  store the SRAM size of log header information.
	  the default value is 1K.
	  should equal with preloader and lk setting.
	  need discussion with ramconsole owner.

config MTK_LOG_STORE_BOOTPROF
	bool "write to emmc enable"
	default n
	depends on MTK_DRAM_LOG_STORE
	help
	  The config item MTK_LOG_STORE_BOOTPROF is
	  used to control the write log expdb partition.
	  which is a debugging feature to record the
	  bootprof log and kernel log to the partition.

	  Enable this to get the bootprof log.

config MTK_LOG_STORE_ALWAYS_CLEAR_EMMC_FLAG
	bool "always clear NEED_SAVE_TO_EMMC flag"
	default n
	depends on MTK_DRAM_LOG_STORE
	help
	  The config item MTK_LOG_STORE_CLEAR_EMMC_FLAG is
	  used to always clear NEED_SAVE_TO_EMMC flag when
	  log_store driver init, even in normal boot mode.
	  This is used to cover the system which cannot clear
	  this flag after boot complete.
```

## kernel/kernel_device_modules-6.6/drivers/misc/mediatek/lpm_legacy/Kconfig
```kconfig
config MTK_LPM_LEGACY
	tristate "Meditaek Low Power Module for Legacy Platforms"
	help
	  For MediaTek Low Power Module, such as CPU idle,
	  CPU suspend low power enhencement.
	  Select "y" if you want to enable low power features.
	  Select "n" if unsure.

config MTK_LPM_DBG_COMMON
	bool "Meditaek Low Power common debug Module"
	help
	  Select MTK_LPM_DBG_COMMON then Mediatek low module
	  common debug feature will be enabled. The common debug
	  feature will support basic debug control and show the
	  information to console.

config MTK_LPM_GS_DUMP_VERSION
	string "Meditaek Low Power golden setting checker version"
	default "v1"
	help
	  Set MTK_LPM_GS_DUMP_VERSION for Mediatek low module
	  golden setting dump mechanism version.

config MTK_LPM_MODULE_NAME
	string "Set mtk-lpm module output name"
	default "generic" if MTK_PLATFORM = ""
	default MTK_PLATFORM if MTK_PLATFORM != ""
	help
	  Customize the debug module output name.
	  Set the specific name for kernel module.
	  The platform name will be set as default
	  name if the MTK_LPM_MODULE_NAME didn't
	  set before.

config MTK_LPM_MT6893
	tristate "Specify Mediatek LPM Platform is MT6893"
	depends on MTK_LPM_LEGACY
	select MTK_LPM_DBG_COMMON
	help
	  Select MediaTek Low Power Module Platform is MT6893
	  for power management.
	  Set Y to select this feature for specific platform-mt6893.

config MTK_LPM_MT6877
	tristate "Specify Mediatek LPM Platform is mt6877"
	depends on MTK_LOW_POWER_MODULE
	select MTK_LPM_DBG_COMMON
	help
	  Select MediaTek Low Power Module Platform is mt6877
	  for power management.
	  Set Y to select this feature for specific platform-mt6877.
	  If unsure, set N to disable.

config MTK_LPM_MT6781
	tristate "Specify Mediatek LPM Platform is mt6781"
	depends on MTK_LOW_POWER_MODULE
	select MTK_LPM_DBG_COMMON
	help
	  Select MediaTek Low Power Module Platform is mt6781
	  for power management.
	  Set Y to select this feature for specific platform-mt6781.
	  If unsure, set N to disable.

config MTK_LPM_MT6853
	tristate "Specify Mediatek LPM Platform is mt6853"
	depends on MTK_LOW_POWER_MODULE
	select MTK_LPM_DBG_COMMON
	help
	  Select MediaTek Low Power Module Platform is mt6853
	  for power management.
	  Set Y to select this feature for specific platform-mt6853.
	  If unsure, set N to disable.

config MTK_LPM_MT6833
	tristate "Specify Mediatek LPM Platform is mt6833"
	depends on MTK_LOW_POWER_MODULE
	select MTK_LPM_DBG_COMMON
	help
	  This configuration option enables support for the MediaTek Low Power Module (LPM)
	  specifically for the mt6833 platform. The LPM is responsible for managing power
	  consumption and optimizing power usage across various components of the system.
	  Select 'Y' to include this support in the kernel, or 'M'
	  to build it as a loadable module.
```
