## kernel/kernel_device_modules-6.6/drivers/misc/mediatek/mbraink/Kconfig
```kconfig
config MTK_MBRAINK
	tristate "MTK MBRAINK support"
	select MTK_MBRAINK_BRIDGE
	help
          MBRAINK is a MediaTek in-house kernel module which can
          communicate with android MBrain.
          Set Y to enable this feature.
          If unsure, Set N to stay with legancy feature.

config MTK_MBRAINK_BRIDGE
	tristate "MTK MBRAINK BRIDGE support"
	depends on MTK_MBRAINK
        help
          MBRAINK BRIDGE is a MediaTek in-house kernel module which can
          communicate with android MBrain.
          Set Y to enable this feature.
          If unsure, Set N to stay with legancy feature.

config MTK_MBRAINK_MT6989
	tristate "Specify Mediatek MBRAINK Platform is MT6989"
	depends on MTK_MBRAINK
	help
	  Select MediaTek MBraink Module Platform is MT6989
	  for android MBrain feature.
	  Set Y to select this feature for specific platform-mt6989.
	  If unsure, set N to disable.

config MTK_MBRAINK_MT6991
	tristate "Specify Mediatek MBRAINK Platform is MT6991"
	depends on MTK_MBRAINK
	help
	  Select MediaTek MBraink Module Platform is MT6991
	  for android MBrain feature.
	  Set Y to select this feature for specific platform-mt6991.
	  If unsure, set N to disable.

config MTK_MBRAINK_MT8678
	tristate "Specify Mediatek MBRAINK Platform is MT8678"
	depends on MTK_MBRAINK
	default n
	help
	  Select MediaTek MBraink Module Platform is MT8678
	  for AUTO MBrain feature.
	  Set Y to select this feature for specific platform-mt8678.
	  If unsure, set N to disable.

config MTK_MBRAINK_MT6899
	tristate "Specify Mediatek MBRAINK Platform is MT6899"
	depends on MTK_MBRAINK
	help
	  Select MediaTek MBraink Module Platform is MT6899
	  for android MBrain feature.
	  Set Y to select this feature for specific platform-mt6899.
	  If unsure, set N to disable.
```

## kernel/kernel_device_modules-6.6/drivers/misc/mediatek/mme/Kconfig
```kconfig
config MMEVENT
	tristate "MMEVENT module enable or disable"
	help
	  Enable other module to use Multimedia event log mechanism.
	  By enable this config, the mme/ driver is built into kernel.
	  Otherwise other module will use empty functions in header file
	  instead. This is to make the event log mechanism driver to be
	  a switchable module.
config MTK_MME_SUPPORT
	tristate "Platform support for MME logging"
	help
	  Select this option to enable support for MME (Multimedia event log
	  mechanism). When enabled (set to 'y' or 'm'), kernel modules
	  can utilize the MME interface to print logs, which can be useful for
	  debugging features or modules.

	  If you are building a kernel and require MME logging, you should
	  enable this option.

	  If unsure, or if MME logging is not required for your platform or use case,
	  it is safe to leave this option disabled (set to 'n'). Disabling MME logging
	  can help reduce kernel size and avoid unnecessary logging overhead.
```

## kernel/kernel_device_modules-6.6/drivers/misc/mediatek/mtprof/Kconfig
```kconfig
config MTPROF
	tristate "Enable MTK profiler/debugger tool"
	default n
	help
	  CONFIG_MTPROF define if mtk profiling/debugger tools should be
	  built-in, module or not. It includes bootprof logger which is for
	  boot time profiling. If you are not sure about whether to
	  enable it or not, please set n.

config BOOTPROF_THRESHOLD_MS
	int "Threshold of driver init duration(ms)"
	depends on MTPROF
	default 15
	help
	  CONFIG_BOOTPROF_THRESHOLD_MS define the threshold of driver init
	  duration.If init duration is larger than threshold, bootprof will
	  record the driver info and init time for boot time profiling.
	  (Unit: millisecond)

config MTK_IRQ_MONITOR_CUSTOM
	tristate "Enable Custom IRQ Monitor"
	default n
	help
	  This option allows the use of a custom IRQ monitor in place of the
	  standard Mediatek IRQ monitor. Enabling this option will disable the
	  default MTK_IRQ_MONITOR and allow the system to utilize alternative
	  debugging methods specifically designed for custom IRQ monitoring.
	  This can be useful for developers who need to debug IRQ behavior
	  with custom tools or in scenarios where the default monitor is not
	  sufficient. If unsure, say N to use the standard Mediatek IRQ monitor.

config MTK_IRQ_MONITOR
	tristate "Enable MTK IRQ Monitor"
	depends on !MTK_IRQ_MONITOR_CUSTOM
	help
	  MTK_IRQ_MONITOR can monitor ISR/SOFTIRQ processing duration,
	  IRQ disabled duration and burst IRQ. Say Y here to enable MTK
	  IRQ monitor. If you are not sure about whether to enable it or not,
	  please set n.

config MTK_IRQ_MONITOR_DEBUG
	tristate "Enable MTK IRQ Monitor Debug"
	help
	  MTK_IRQ_MONITOR_DEBUG if used to debug ISR/SOFTIRQ processing
	  duration, IRQ disabled duration and burst IRQ. It is only enabled
	  on userdebug load. Say Y here to enable MTK IRQ monitor debug.
	  If you are not sure about whether to enable it or not,
	  please set n.

config MTK_IRQ_MONITOR_DEFAULT_ENABLED
	bool "Enable all tracers of MTK IRQ Monitor by default"
	depends on MTK_IRQ_MONITOR
	select TRACE_IRQFLAGS

config MTK_IRQ_MONITOR_IRQ_TIMER_OVERRIDE
	bool "Override the thresholds of irq duration timer (ms)"
	depends on MTK_IRQ_MONITOR
```

## kernel/kernel_device_modules-6.6/drivers/misc/mediatek/pcie/Kconfig
```kconfig
# SPDX-License-Identifier: GPL-2.0

config DEVICE_MODULES_PCIE_MEDIATEK_SMT
	tristate  "Mediatek PCIe SMT test"
	help
	  The PCIe SMT test requires enabled the CONFIG. PCIe SMT test
	  items include lane margin, loopback, compliance test, etc.
	  Set Y to enable this feature.
	  If unsure, Set N.
```

## kernel/kernel_device_modules-6.6/drivers/misc/mediatek/pkvm_mgmt/Kconfig
```kconfig
config MTK_PKVM_MTK_SMC_HANDLER
	tristate "MTK pKVM smc handler"
	help
	  A new option CONFIG_MTK_PKVM_MTK_SMC_HANDLER for the feature.
	  This is used for handling el1 in pKVM(EL2). If you
	  are not sure about whether to enable it or not,
	  please set n.
```

## kernel/kernel_device_modules-6.6/drivers/misc/mediatek/pkvm_mkp/Kconfig
```kconfig
config MTK_PKVM_MKP
	tristate "MTK pKVM mkp"
	help
	  A new option CONFIG_MTK_PKVM_MKP for the feature.
	  This is used for printing log in pKVM(EL2). If you
	  are not sure about whether to enable it or not,
	  please set n.
```

## kernel/kernel_device_modules-6.6/drivers/misc/mediatek/pkvm_smmu/Kconfig
```kconfig
config MTK_PKVM_SMMU
	tristate "MTK pKVM smmu"
	help
	  A new option CONFIG_MTK_PKVM_SMMU for the feature.
	  This is used for handling smmu in pKVM(EL2). If you
	  are not sure about whether to enable it or not,
	  please set n.
```

## kernel/kernel_device_modules-6.6/drivers/misc/mediatek/pkvm_tmem/Kconfig
```kconfig
config MTK_PKVM_TMEM
	tristate "MTK tmem support"
	help
	  A new option CONFIG_MTK_PKVM_TMEM for pKVM.
	  tmem support pKVM, so need to enable this option, then
	  normal hypervisor will use pKVM and tmem provide pkvm_tmem
	  EL2 vendor module to do secure memory.
	  Say Y if you would like to enable this feature.
	  Say M if you would like to build it as a kernel module.
```
