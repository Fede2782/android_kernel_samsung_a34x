## kernel/kernel_device_modules-6.6/drivers/misc/mediatek/adsp/Kconfig
```kconfig
config MTK_AUDIODSP_SUPPORT
	tristate "MTK Audio DSP Support"
	help
	  AUDIO_DSP is a MediaTek in-house DSP which can do
	  different audio process.
	  Set Y to enable this feature.
	  If unsure, Set N to stay with legancy feature.

config MTK_ADSP_V0
	tristate "MTK Audio DSP Generation 0"
	depends on MTK_AUDIODSP_SUPPORT
	help
	  This kernel config can be used to enable Audio DSP
	  Generation 0 driver for specific plaforms.
	  it need to enable MTK_AUDIODSP_SUPPORT for basic functions.
	  Set Y to enable this feature.
	  If unsure, say N.

config MTK_ADSP_V1
	tristate "MTK Audio DSP Generation 1"
	depends on MTK_AUDIODSP_SUPPORT
	help
	  This kernel config can be used to enable Audio DSP
	  Generation 1 driver for specific plaforms.
	  it need to enable MTK_AUDIODSP_SUPPORT for basic functions.
	  Set Y to enable this feature.
	  If unsure, say N.

config MTK_ADSP_V2
	tristate "MTK ADSP DSP Generation 2"
	depends on MTK_AUDIODSP_SUPPORT
	help
	  This kernel config can be used to enable Audio DSP
	  Generation 2 driver for specific plaforms.
	  it need to enable MTK_AUDIODSP_SUPPORT for basic functions.
	  Set Y to enable this feature.
	  If unsure, say N.

config MTK_AUDIODSP_DEBUG_SUPPORT
	bool "MTK Audio DSP Debug support"
	help
	  This is a debug interface for Audio DSP
	  Set Y to enable this feature.
	  Set N to disable this feature.
	  If unsure, Set N to disable it.

config MTK_ADSP_AUTO_HFP_CLIENT_SUPPORT
	tristate "MTK AUDIODSP AUTO HFP CLIENT SUPPORT"
	depends on MTK_AUDIODSP_SUPPORT
	help
	  This kernel config can be used to enable Audio DSP
	  HFP client feature.
	  It needs to enable MTK_AUDIODSP_SUPPORT for basic functions.
	  Set Y to enable this feature.
	  If unsure, say N.

config MTK_ADSP_AUTO_ANC_SUPPORT
	tristate "MTK AUDIODSP AUTO ANC SUPPORT"
	depends on MTK_AUDIODSP_SUPPORT
	help
	  This kernel config can be used to enable Audio DSP
	  ANC feature.
	  It needs to enable MTK_AUDIODSP_SUPPORT for basic functions.
	  Set Y to enable this feature.
	  If unsure, say N.

config MTK_ADSP_AUTO_EXTSTREAM_SUPPORT
	tristate "MTK AUDIODSP AUTO EXTSTREAM SUPPORT"
	depends on MTK_AUDIODSP_SUPPORT
	help
	  This kernel config can be used to enable Audio DSP
	  EXTSTREAM feature.
	  It needs to enable MTK_AUDIODSP_SUPPORT for basic functions.
	  Set Y to enable this feature.
	  If unsure, say N.

config SND_SOC_MTK_AUTO_AUDIO_DSP
	tristate "Auto Audio DSP support"
	help
	  This add automotive adsp base on audio dsp. This enable
	  the function for automotive playback
	  to audiodsp.
	  Select Y if you have such device.
	  If unsure select "N".

config MTK_ADSP_AUTO_MULTI_PLAYBACK_SUPPORT
	tristate "Auto Audio DSP support"
	depends on SND_SOC_MTK_AUTO_AUDIO_DSP
	help
	  This kernel config can be used to enable Audio DSP
	  sub_playback tasks for multi_playback.
	  It needs to enable MTK_AUDIODSP_SUPPORT & SND_SOC_MTK_AUTO_AUDIO_DSP for basic functions.
	  Set Y to enable this feature.
	  If unsure, say N.
```

## kernel/kernel_device_modules-6.6/drivers/misc/mediatek/audio_ipi/Kconfig
```kconfig
config MTK_AUDIO_IPI
	tristate "Enable MTK audio ipi support"
	depends on MTK_AUDIODSP_SUPPORT || MTK_SCP_AUDIO
	default m
	help
	  This option enables MTK audio ipi modules to communicate
	  with subsystem.
	  This option depends on MediaTek in-house audio DSP support
	  or audio feature support on MediaTek in-house DSP.

config DEVICE_MODULES_VHOST_ADSP
	tristate "Host kernel accelerator for virtio blk (EXPERIMENTAL)"
	depends on BLOCK
	select VHOST
	help
	  This kernel module can be loaded in host kernel to accelerate
	  guest block with virtio_adsp. Not to be confused with virtio_adsp
	  module itself which needs to be loaded in guest kernel.

	  To compile this driver as a module, choose M here: the module will
	  be called vhost_adsp.

config ADSP_VOIP_LEGACY
	bool "Enable voip DL and UL support on same coreB"
	depends on MTK_AUDIODSP_SUPPORT || CONFIG_MTK_AUDIO_IPI
	default n
	help
	  Enable support for VoIP Downlink (DL) and Uplink (UL) on the same core for legacy chips with dual-core ADSP.
	  This option is necessary for older architectures where VoIP DL and UL cannot be handled on separate cores.
	  Newer architectures support VoIP DL and UL on separate cores, but this feature is not available on older chips.
	  If you are unsure, select "N".
```

## kernel/kernel_device_modules-6.6/drivers/misc/mediatek/cameraisp/fdvt/Kconfig
```kconfig
config MTK_CAMERA_FD_VERSION35
	tristate "[FD] Face Detection"
	depends on MTK_CAMERA_ISP_SUPPORT
	help
	  Face Detection.
	  Enable to detect faces on images.
	  Disable if it is not supported or
	  not wanted.

config MTK_CAMERA_FD_VERSION40
	tristate "[FD] Face Detection"
	depends on MTK_CAMERA_ISP_SUPPORT
	help
	  Face Detection.
	  Enable to detect faces on images.
	  Disable if it is not supported or
	  not wanted.
config MTK_CAMERA_FD_ISP6S
	tristate "[FD] Face Detection"
	depends on MTK_CAMERA_ISP_SUPPORT
	help
	  Face Detection.
	  Enable to detect faces on images.
	  Disable if it is not supported or
	  not wanted.
config MTK_CAMERA_FD_ISP6S_V1
	tristate "[FD] Face Detection"
	depends on MTK_CAMERA_ISP_SUPPORT
	help
	  Face Detection.
	  Enable to detect faces on images.
	  Disable if it is not supported or
	  not wanted.
config MTK_CAM_SECURE_FD_SUPPORT
	tristate "[FD] Secure Face Detection"
	depends on MTK_CAMERA_ISP_SUPPORT
	help
	  Face Detection.
	  Enable to detect faces on images
	  for secure mode. Disable if it is
	  not supported or not wanted.
```

## kernel/kernel_device_modules-6.6/drivers/misc/mediatek/carevent/Kconfig
```kconfig
config MTK_SPM_CAREVENT
	tristate "smartplatform car event detection"
	help
	  Say M here if system has a capability
	  for detecting car event.
	  Such as: engine on/off, car reverse.
	  If unsure, say N.
```

## kernel/kernel_device_modules-6.6/drivers/misc/mediatek/cg_ppt/Kconfig
```kconfig
config MTK_CG_PEAK_POWER_THROTTLING
	tristate "MTK CPU GPU peak power throttling"
	help
	  For MediaTek CPU GPU peak power throttling.
	  Throttle MTK CPU GPU power when MTK peak power throttling triggers
	  Select "y" if you want to enable MTK CPU GPU peak power throttling
	  feature
	  Select "n" if unsure.

config MTK_CG_PPT_MODE_OFF
	tristate "MTK CG PPT default off"
	default n
	help
	  For Setting Mediatek CPU GPU Peak Power throttling mode default off.
	  Select "y" if you want to set MTK CPU GPU peak power throttling default
	  mode off
	  Select "n" if unsure.
```

## kernel/kernel_device_modules-6.6/drivers/misc/mediatek/cm_mgr_legacy_v1/Kconfig
```kconfig
config MTK_CM_IPI
	tristate "MTK CM use IPI"
	help
	  This kernel config can be used to enable CM IPI. When enable
	  this option, we will use ipi on system buffer to improve
	  performance and power.
	  If unsure, say N.

config MTK_CM_MGR_LEGACY_V1
	tristate "MTK CM_MGR for LEGACY V1"
	help
	  This kernel config can be used to enable CM_MGR. When enable
	  this option, dram opp level will be changed which will depended
	  on power table.
	  If unsure, say N.

config MTK_CM_MGR_MT6768
	tristate "MTK CM_MGR for MT6768"
	help
	  This kernel config can be used to enable CM_MGR MT6768. When enable
	  this option, dram opp level will be changed which will depended
	  on power table.
	  If unsure, say N.

config MTK_CM_MGR_MT6877
	tristate "MTK CM_MGR for MT6877"
	help
	  This kernel config can be used to enable CM_MGR MT6877. When enable
	  this option, dram opp level will be changed which will depended
	  on power table.
	  If unsure, say N.

config MTK_CM_MGR_MT6893
	tristate "MTK CM_MGR for MT6893"
	help
	  This kernel config can be used to enable CM_MGR MT6893. When enable
	  this option, dram opp level will be changed which will depended
	  on power table.
	  If unsure, say N.

config MTK_CM_MGR_MT6853
	tristate "MTK CM_MGR for MT6853"
	help
	  This kernel config can be used to enable CM_MGR MT6853. When enable
	  this option, dram opp level will be changed which will depended
	  on power table.
	  If unsure, say N.

config MTK_CM_MGR_MT6781
	tristate "MTK CM_MGR for MT6781"
	help
	  This kernel config can be used to enable CM_MGR MT6781. When enable
	  this option, dram opp level will be changed which will depended
	  on power table.
	  If unsure, say N.

config MTK_CM_MGR_MT6833
	tristate "MTK CM_MGR for MT6833"
	help
	  This kernel config can be used to enable CM_MGR MT6833. When enable
	  this option, dram opp level will be changed which will depended
	  on power table.
	  If unsure, say N.
```

## kernel/kernel_device_modules-6.6/drivers/misc/mediatek/cmdq/Kconfig
```kconfig
config MTK_CMDQ_MBOX_EXT
	tristate "enable CMDQ mailbox driver extension"
	help
	  This extension enable debug feature, such as cmdq-status,
	  cmdq-record, pre-dump, timeout error dump, first error buffer
	  and aee db. Enable performance tools which add instruction
	  inside packet and profiling. Also enable secure path with
	  new sec controller which decuple with v3 driver.

config MTK_CMDQ_MBOX_EXT_MT6768
	tristate "enable CMDQ mailbox driver extension on mt6768"
	help
	  This extension enable debug feature, such as cmdq-status,
	  cmdq-record, pre-dump, timeout error dump, first error buffer
	  and aee db. Enable performance tools which add instruction
	  inside packet and profiling. Also enable secure path with
	  new sec controller which decuple with v3 driver.

config MTK_CMDQ_MBOX_EXT_MT6765
	tristate "enable CMDQ mailbox driver extension on mt6765"
	help
	  This extension enable debug feature, such as cmdq-status,
	  cmdq-record, pre-dump, timeout error dump, first error buffer
	  and aee db. Enable performance tools which add instruction
	  inside packet and profiling. Also enable secure path with
	  new sec controller which decuple with v3 driver.

config MTK_CMDQ_MBOX_EXT_MT6761
	tristate "enable CMDQ mailbox driver extension on mt6761"
	help
	  This extension enable debug feature, such as cmdq-status,
	  cmdq-record, pre-dump, timeout error dump, first error buffer
	  and aee db. Enable performance tools which add instruction
	  inside packet and profiling. Also enable secure path with
	  new sec controller which decuple with v3 driver.

config MTK_CMDQ_MBOX_EXT_MT6739
	tristate "enable CMDQ mailbox driver extension on mt6739"
	help
	  This extension enable debug feature, such as cmdq-status,
	  cmdq-record, pre-dump, timeout error dump, first error buffer
	  and aee db. Enable performance tools which add instruction
	  inside packet and profiling. Also enable secure path with
	  new sec controller which decuple with v3 driver.

config MTK_CMDQ_DEBUG
	tristate "enable CMDQ mailbox driver hw trace debug extension"
	help
	  This extension enables hw trace feature for cmdq driver, we
	  only default enable hw trace feature in userdebug/eng load, and avoid
	  user load for performance concern. But for hw trace feature,
	  user can enable/disable it with adb command.

config VIRTIO_CMDQ
	tristate "enable VIRTIO CMDQ  driver"
	help
	  This extension enable virtio cmdq driver, virtio cmdq driver
	  for hypervisor project. The virtio driver is located at mailbox/virtio,
	  Also used to isolate the conflicting part of the cmdq driver
	  on main project, default is n.
```

## kernel/kernel_device_modules-6.6/drivers/misc/mediatek/cpufreq_v2/Kconfig
```kconfig
config MEDIATEK_CPU_DVFS
	tristate "Mediatek cpu dvfs debug driver"
	help
	  This kernel config can be used to debug cpu dvfs (dynamic voltage
	  and frequency scaling) for Mediatek cpufreq driver.
	  When enable this option, we can dump the dvfs log and check
	  physical frequency
          If unsure, say N.

config MTK_DVFS_MT6768
	tristate "Specify Mediatek CPU_DVFS Platform is MT6768"
	depends on MEDIATEK_CPU_DVFS
	help
	  Select MediaTek Low Power Module Platform is MT6768
	  for power management.
	  Set Y to select this feature for specific platform-MT6768.
	  If unsure, set N to disable.

config MTK_DVFS_MT6739
	tristate "Specify Mediatek CPU_DVFS Platform is MT6739"
	depends on MEDIATEK_CPU_DVFS
	help
	  Select MediaTek Low Power Module Platform is MT6739
	  for power management.
	  Set Y to select this feature for specific platform-MT6739.
	  If unsure, set N to disable.

config MEDIATEK_CPU_DVFS_MT6761
	tristate "Specify Mediatek CPU_DVFS Platform is MT6761"
	depends on MEDIATEK_CPU_DVFS
	help
	  Select MediaTek Low Power Module Platform is MT6761
	  for power management.
	  Set Y to select this feature for specific platform-MT6761.
	  If unsure, set N to disable.

config MEDIATEK_CPU_DVFS_MT6765
	tristate "Specify Mediatek CPU_DVFS Platform is MT6765"
	depends on MEDIATEK_CPU_DVFS
	help
	  Select MediaTek Low Power Module Platform is MT6765
	  for power management.
	  Set Y to select this feature for specific platform-MT6765.
	  If unsure, set N to disable.

config MEDIATEK_CPU_DVFS_MT6877
	tristate "Specify Mediatek CPU_DVFS Platform is MT6877"
	depends on MEDIATEK_CPU_DVFS
	help
	  Select MediaTek Low Power Module Platform is MT6877
	  for power management.
	  Set Y to select this feature for specific platform-MT6877.
	  If unsure, set N to disable.

config MEDIATEK_CPUFREQ_DEBUG_SUPPORT_LEGACY
    bool "Disable mediatek cpu dvfs debug function for legacy chips"
    help
      This option disables the debug feature of cpu dvfs
	  for Mediatek cpufreq driver.
      It's applied when the platform doesn't support debug nodes.
      The related debug files path are located at
	  'kernel_modules/cpufreq_cus' and 'kernel_modules/cpufreq_int'.
      If unsure, say N.

config MTK_CPU_DVFS_ENG_DEBUG
	bool "Enable certain cpu dvfs debug nodes for eng build"
	depends on MEDIATEK_CPU_DVFS
	help
	 This option enables certain CPU DVFS (Dynamic Voltage and Frequency Scaling) debug nodes
	 specifically for engineering builds.
	 Select "y" to enable these debug nodes.
	 Select "n" if you are unsure or do not need these additional debug features.
```

## kernel/kernel_device_modules-6.6/drivers/misc/mediatek/cross_sched/Kconfig
```kconfig
config MTK_CROSS_SCHEDULER
	tristate "MTK cross domain schedule"
	help
	  MTK cross domain schedule.
	  The feature can effectively adjust the host and vm direct resource
	  utilization, thus improving the fluency of the whole system.
	  If you are not sure about whether to enable it or not,
	  please set n.
```
