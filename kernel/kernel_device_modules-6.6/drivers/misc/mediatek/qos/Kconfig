## kernel/kernel_device_modules-6.6/drivers/misc/mediatek/qos/Kconfig
```kconfig
config MTK_QOS_FRAMEWORK
	tristate "MTK QOS FRAMEWORK"
	help
	  This kernel config can be used to enable MTK QOS FRAMEWORK.
	  When enabling this option, BW Limiter and BW Bound Detector
	  will be enabled and set EMI hardware.
	  If unsure, say N.

config MTK_QOS_MT6893
	tristate "MTK QOS for MT6893"
	help
	  This kernel config can be used to enable MTK QOS MT6893.
	  When enabling this option, BW Limiter and BW Bound Detector
	  will be enabled and set EMI hardware.
	  If unsure, say N.

config MTK_QOS_MT6877
	tristate "MTK QOS for MT6877"
	help
		This kernel config can be used to enable MTK QOS MT6877.
		When enabling this option, BW Limiter and BW Bound Detector
		will be enabled and set EMI hardware.
		If unsure, say N.

config MTK_QOS_MT6833
	tristate "MTK QOS for MT6833"
	help
          This kernel config can be used to enable MTK QOS MT6833.
	  When enabling this option, BW Limiter and BW Bound Detector
	  will be enabled and set EMI hardware.
	  If unsure, say N.

config MTK_QOS_LEGACY
	tristate "MTK QOS for MT6761, MT6765, MT6768"
	help
	This kernel config can be used to enable MTK QOS MT6768.
	When enabling this option, BW Limiter and BW Bound Detector
	will be enabled and set EMI hardware.
	If unsure, say N.

config MTK_QOS_BOUND_LEGACY
	bool "Enable QoS Bound Feature for Legacy MTK Chips"
	help
	  Enable this option to activate the QoS Bound feature on
	  legacy MTK chips.
	  This feature is essential for managing bandwidth and
	  ensuring the Quality of Service on these older platforms by
	  enforcing bandwidth limitations and detecting bandwidth bounds.
	  It is recommended to enable this option if you are working with
	  legacy chips to utilize the full capabilities of the QoS system.
	  If unsure, say N.
```

## kernel/kernel_device_modules-6.6/drivers/misc/mediatek/rootfs_check/Kconfig
```kconfig
config ROOTFS_CHECK
	tristate "Mediatek Rootfs Secure Boot Check"
	help
	  Enable rootfs secure boot check on yocto system when rootfs mount.
	  When enabled, the rootfs image would be signed while build and the
	  signature would append the end of the rootfs image, then verify
	  the signature when mount.
	  If enabled the rootfs would be readonly.
```

## kernel/kernel_device_modules-6.6/drivers/misc/mediatek/sensor/1.0/Kconfig
```kconfig
# SPDX-License-Identifier: GPL-2.0

menu "Sensors"

config MTK_SENSOR_ARCHITECTURE
	string "MTK SENSOR ARCHITECTURE"
	default "dummy"
	help
	  Sensor config for sensor architecture in project.
	  Please set 1.0/2.0/3.0 etc if you want to support sensor
	  with mediatek sensor architecture.
	  If unsure, set dummy.
endmenu # Sensors

source "$(KCONFIG_EXT_PREFIX)drivers/misc/mediatek/sensor/1.0/accelerometer/Kconfig"
source "$(KCONFIG_EXT_PREFIX)drivers/misc/mediatek/sensor/1.0/alsps/Kconfig"
source "$(KCONFIG_EXT_PREFIX)drivers/misc/mediatek/sensor/1.0/gyroscope/Kconfig"
source "$(KCONFIG_EXT_PREFIX)drivers/misc/mediatek/sensor/1.0/magnetometer/Kconfig"
source "$(KCONFIG_EXT_PREFIX)drivers/misc/mediatek/sensor/1.0/hwmon/Kconfig"
source "$(KCONFIG_EXT_PREFIX)drivers/misc/mediatek/sensor/1.0/barometer/Kconfig"
source "$(KCONFIG_EXT_PREFIX)drivers/misc/mediatek/sensor/1.0/step_counter/Kconfig"
source "$(KCONFIG_EXT_PREFIX)drivers/misc/mediatek/sensor/1.0/situation/Kconfig"
source "$(KCONFIG_EXT_PREFIX)drivers/misc/mediatek/sensor/1.0/sensorHub/Kconfig"
source "$(KCONFIG_EXT_PREFIX)drivers/misc/mediatek/sensor/1.0/sensorfusion/Kconfig"
```

## kernel/kernel_device_modules-6.6/drivers/misc/mediatek/sensor/1.0/alsps/Kconfig
```kconfig
config CUSTOM_KERNEL_ALSPS
	bool "CUSTOM KERNEL ALSPS Config"
	help
	  ALSPS sensor driver to detect ambient light and the object is close
	  or far awary from device. After configure this configuration,
	  the specific ambient light and proximity sensor driver configuration
	  should be configured as well.

config MTK_AUTO_DETECT_ALSPS
	bool "MTK AUTO DETECT ALSPS Sensor"
	help
	  This feature Option is used for projects which using more than one
	  ALSPS sensors, more than one ALSPS drivers can be builded in to
	  project and be auto detected by setting this option to yes,
	  usually only one ALSPS driver can be probed.

source "$(KCONFIG_EXT_PREFIX)drivers/misc/mediatek/sensor/1.0/alsps/alspshub/Kconfig"
source "$(KCONFIG_EXT_PREFIX)drivers/misc/mediatek/sensor/1.0/alsps/cm36558/Kconfig"
#source "$(KCONFIG_EXT_PREFIX)drivers/misc/mediatek/sensor/1.0/alsps/ltr303/Kconfig"
```

## kernel/kernel_device_modules-6.6/drivers/misc/mediatek/sensor/1.0/barometer/Kconfig
```kconfig
config CUSTOM_KERNEL_BAROMETER
	bool "CUSTOM KERNEL BAROMETER Config"
	help
	  one load to support different barometer sensor.
	  This feature Option is used for projects which using more than one
	  barometer, and be auto detected by setting this option to yes
	  If unsure, say N.

source "$(KCONFIG_EXT_PREFIX)drivers/misc/mediatek/sensor/1.0/barometer/barohub/Kconfig"
source "$(KCONFIG_EXT_PREFIX)drivers/misc/mediatek/sensor/1.0/barometer/BMP280-new/Kconfig"
```

## kernel/kernel_device_modules-6.6/drivers/misc/mediatek/sensor/1.0/gyroscope/Kconfig
```kconfig
config CUSTOM_KERNEL_GYROSCOPE
	bool "CUSTOM KERNEL GYROSCOPE Config"
	help
	  gyroscope sensor to detect gyroscope from x y z axis.
	  If the platform is supported for gyroscope, this
	  configuration should be configured, and the gyroscope
	  driver configuration should be configured as well.

source "$(KCONFIG_EXT_PREFIX)drivers/misc/mediatek/sensor/1.0/gyroscope/gyrohub/Kconfig"
#source "$(KCONFIG_EXT_PREFIX)drivers/misc/mediatek/sensor/1.0/gyroscope/bmi160gy-i2c/Kconfig"
source "$(KCONFIG_EXT_PREFIX)drivers/misc/mediatek/sensor/1.0/gyroscope/ITG1010/Kconfig"
#source "$(KCONFIG_EXT_PREFIX)drivers/misc/mediatek/sensor/1.0/gyroscope/mpu6050gy/Kconfig"
```

## kernel/kernel_device_modules-6.6/drivers/misc/mediatek/sensor/1.0/sensorHub/Kconfig
```kconfig
config CUSTOM_KERNEL_SENSORHUB_1_0
	bool "CUSTOM KERNEL SENSORHUB 1 0 config"
	help
	  Kernel space sensor hub driver.
	  Define project used all sensor hub
	  sensors. The value is combination of sensor hub driver(get data...etc)
	  and sensor hub framework driver(transmit shf info)

#source "$(KCONFIG_EXT_PREFIX)drivers/misc/mediatek/sensor/1.0/sensorHub/SCP_sensorHub/Kconfig"
#source "$(KCONFIG_EXT_PREFIX)drivers/misc/mediatek/sensor/1.0/sensorHub/SCP_sensorHub_v1/Kconfig"
#source "$(KCONFIG_EXT_PREFIX)drivers/misc/mediatek/sensor/1.0/sensorHub/SCP_shf/Kconfig"

source "$(KCONFIG_EXT_PREFIX)drivers/misc/mediatek/sensor/1.0/sensorHub/nanohub/Kconfig"
```

## kernel/kernel_device_modules-6.6/drivers/misc/mediatek/sensor/1.0/situation/Kconfig
```kconfig
config CUSTOM_KERNEL_SITUATION
	bool "mediatek situation sensor tag"
	help
	  Kernel space support situation sensor driver.
	  If the platform is supported for gesture, this
	  configuration should be configured, and the situation
	  driver configuration should be configured as well.

source "$(KCONFIG_EXT_PREFIX)drivers/misc/mediatek/sensor/1.0/situation/situation_hub/Kconfig"
```

## kernel/kernel_device_modules-6.6/drivers/misc/mediatek/sensor/1.0/situation/situation_hub/Kconfig
```kconfig
source "$(KCONFIG_EXT_PREFIX)drivers/misc/mediatek/sensor/1.0/situation/situation_hub/stationary/Kconfig"
source "$(KCONFIG_EXT_PREFIX)drivers/misc/mediatek/sensor/1.0/situation/situation_hub/inpocket/Kconfig"
source "$(KCONFIG_EXT_PREFIX)drivers/misc/mediatek/sensor/1.0/situation/situation_hub/wake_gesture/Kconfig"
source "$(KCONFIG_EXT_PREFIX)drivers/misc/mediatek/sensor/1.0/situation/situation_hub/glance_gesture/Kconfig"
source "$(KCONFIG_EXT_PREFIX)drivers/misc/mediatek/sensor/1.0/situation/situation_hub/answercall/Kconfig"
source "$(KCONFIG_EXT_PREFIX)drivers/misc/mediatek/sensor/1.0/situation/situation_hub/pickup_gesture/Kconfig"
source "$(KCONFIG_EXT_PREFIX)drivers/misc/mediatek/sensor/1.0/situation/situation_hub/device_orientation/Kconfig"
source "$(KCONFIG_EXT_PREFIX)drivers/misc/mediatek/sensor/1.0/situation/situation_hub/motion_detect/Kconfig"
source "$(KCONFIG_EXT_PREFIX)drivers/misc/mediatek/sensor/1.0/situation/situation_hub/tilt_detector/Kconfig"
source "$(KCONFIG_EXT_PREFIX)drivers/misc/mediatek/sensor/1.0/situation/situation_hub/flat/Kconfig"
source "$(KCONFIG_EXT_PREFIX)drivers/misc/mediatek/sensor/1.0/situation/situation_hub/sar/Kconfig"
```

## kernel/kernel_device_modules-6.6/drivers/misc/mediatek/smap/Kconfig
```kconfig
config MTK_SMAP
	bool "MTK SMAP"
	help
	  Say yes here to add support for the MediaTek SMAP (System Max Power
	  Mitigation). The SMAP IP support Imax scenario detection and power
	  mitigation.
	  If unsure, say N.

config MTK_SMAP_MT6991
	tristate "MTK SMAP_MT6991"
	select MTK_SMAP
	help
	  This kernel config can be used to enable SMAP at mt6991.
	  When enable this option, it can support Imax scenario detection
	  and power mitigation.
	  If unsure, say N.
```

## kernel/kernel_device_modules-6.6/drivers/misc/mediatek/smi/Kconfig
```kconfig
config MTK_SMI_BWC
	tristate "MediaTek BWC driver"
	help
	  BWC is mainy to optimize the bus access latency based on
	  multimedia scenarios.
	  It is required for many MTK multimedia middlewares including
	  camera and video middlewares on some legacy chips.
	  This config enables BWC functions.

config MTK_SMI_BWC_MT6761
	tristate "MediaTek BWC driver for MT6761"
	help
	  BWC is mainly to optimize the bus access latency based on
	  multimedia scenarios.
	  It is required for many MTK multimedia middlewares including
	  camera and video middlewares on some legacy chips.
	  This config enables BWC functions.

config MTK_SMI_BWC_MT6739
	tristate "MediaTek BWC driver for MT6739"
	help
	  BWC is mainly to optimize the bus access latency based on
	  multimedia scenarios.
	  It is required for many MTK multimedia middlewares including
	  camera and video middlewares on some legacy chips.
	  This config enables BWC functions.

config MTK_SMI_BWC_V6765
	tristate "MediaTek BWC driver for MT6765"
	help
	  BWC is mainly to optimize the bus access latency based on
	  multimedia scenarios.
	  It is required for many MTK multimedia middlewares including
	  camera and video middlewares on some legacy chips.
	  This config enables BWC functions.
```

## kernel/kernel_device_modules-6.6/drivers/misc/mediatek/swpm_legacy/Kconfig
```kconfig
config MTK_SWPM_MODULE_LEGACY
	tristate "Meditaek Software Power Model Module V1"
	help
	  For MediaTek Software Power Model Module,
	  modling SoC likes CPU, GPU and DRAM power.
	  Select "y" if you want to enable SWPM features.
	  Select "n" if unsure.

config MTK_SWPM_MT6877
	tristate "Specify Mediatek SWPM Platform is MT6877"
	depends on MTK_SWPM_MODULE_LEGACY
	help
	  Select MediaTek Software Power Model Platform is MT6877
	  for power management.
	  Set Y to select this feature for specific platform-mt6877.
	  If unsure, set N to disable.
```

## kernel/kernel_device_modules-6.6/drivers/misc/mediatek/trusty/Kconfig
```kconfig
#
# Trusty
#

menu "Trusty"

config TRUSTY
	tristate "Trusty"
	default n

config TRUSTY_FIQ
	tristate
	depends on TRUSTY

config TRUSTY_FIQ_ARM
	tristate
	depends on TRUSTY
	depends on ARM
	select FIQ_GLUE
	select TRUSTY_FIQ
	default y

config TRUSTY_FIQ_ARM64
	tristate
	depends on TRUSTY
	depends on ARM64
	select FIQ_GLUE
	select TRUSTY_FIQ
	default y

config TRUSTY_LOG
	tristate
	depends on TRUSTY
	default y

config TRUSTY_VIRTIO
	tristate "Trusty virtio support"
	depends on TRUSTY
	select VIRTIO
	default y

config TRUSTY_VIRTIO_IPC
	tristate "Trusty Virtio IPC driver"
	depends on TRUSTY_VIRTIO
	default y
	help
	  This module adds support for communications with Trusty Services

	  If you choose to build a module, it'll be called trusty-ipc.
	  Say N if unsure.

config TRUSTY_BUG_ON_WARN
	tristate "Trusty enable warning as BUG_ON"
	depends on TRUSTY_VIRTIO_IPC
	depends on MTK_AEE_FEATURE
	default n
	help
	  Enable BUG_ON when trusty met the trouble to confirm issue by
	  AEE. Such as time-out of IPC etc.

	  Select this if you want to enable above facilities.
	  If unsure, say N.

config TRUSTY_TIPC_FOOTPRINT
	tristate "Trusty TIPC footprint"
	depends on TRUSTY_VIRTIO_IPC
	default n
	help
	  The debug feature which enables tipc footprint to trace tipc
	  flow between REE/iSE.

	  Select this if you want to enable above facilities.
	  If unsure, say N.

endmenu
```

## kernel/kernel_device_modules-6.6/drivers/misc/mediatek/vhost_dmabuf_phys/Kconfig
```kconfig
#
# SPM vhost dmabuf exporter phy config
#

config MTK_SPM_VHOST_DMABUF_PHYS
	tristate "smartplatform vhost dmabuf phy"
	help
	  You can use this driver to export
	  file descriptor from dmabuf sg-list.
	  To compile this driver, choose M.
	  If unsure, say N.
```

## kernel/kernel_device_modules-6.6/drivers/misc/mediatek/wla/Kconfig
```kconfig
config MTK_WLA
	tristate "Meditaek Work Load Aware"
	help
	  For MediaTek Work Load Aware.
	  WLA is used to optimize low power.
	  Select "y/m" if you want to enable wla.
	  Select "n" if unsure.
```
