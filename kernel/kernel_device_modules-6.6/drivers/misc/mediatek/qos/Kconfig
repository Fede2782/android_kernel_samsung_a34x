## kernel/kernel_device_modules-6.6/drivers/mmc/host/Kconfig
```kconfig
# SPDX-License-Identifier: GPL-2.0-only
#
# MMC/SD host controller drivers
#

comment "MMC/SD/SDIO Host Controller Drivers"

config DEVICE_MODULES_MMC_DEBUG
    tristate "MMC host drivers debugging"
    depends on MMC != n
    help
      This is an option for use by developers; most people should
      say N here. This enables MMC host driver debugging. And further
      added host drivers please don't invent their private macro for
      debugging.

config DEVICE_MODULES_MMC_MTK
	tristate "MediaTek SD/MMC Card Interface support"
	depends on HAS_DMA
	depends on COMMON_CLK
	select REGULATOR
	select DEVICE_MODULES_MMC_CQHCI
	help
	  This selects the MediaTek(R) Secure digital and Multimedia card Interface.
	  If you have a machine with a integrated SD/MMC card reader, say Y or M here.
	  This is needed if support for any SD/SDIO/MMC devices is required.
	  If unsure, say N.

config DEVICE_MODULES_MMC_MTK_PRO
	tristate "MediaTek SD/MMC Card Proprietary Interface support"
	depends on !DEVICE_MODULES_MMC_MTK
	help
	  This selects the MediaTek(R) Secure digital and Multimedia card
	  Interface. If you have a machine with a integrated SD/MMC card
	  reader, say Y or M here.

	  If unsure, say N.

config SEC_MMC_FEATURE
	tristate "SEC specific MMC/SD feature"
	depends on DEVICE_MODULES_MMC_MTK_PRO
	help
	  Enable Samsung MMC/SD feature support.
	  Enabling this allows kernel to use SEC specific feature
	  defined and implemented by SEC.

config DEVICE_MODULES_MMC_CQHCI
	tristate "Command Queue Host Controller Interface support"
	depends on HAS_DMA
	help
	  This selects the Command Queue Host Controller Interface (CQHCI)
	  support present in host controllers of Qualcomm Technologies, Inc
	  amongst others.
	  This controller supports eMMC devices with command queue support.

	  If you have a controller with this interface, say Y or M here.

	  If unsure, say N.

config DEVICE_MODULES_MMC_MTK_MMC_WP
	tristate "MediaTek eMMC Write Protect Group support"
	help
	  Set read-only on the partitions belonging to eMMC write protect groups.
	  If you set write protect on eMMC, say Y or M here.
	  If unsure, say N.

config DEVICE_MODULES_MMC_MTK_SW_CQHCI
	tristate "Sofeware Command Queue Host Controller Interface support"
	help
		Some mmc host maybe not have CQHCI hardware.
		This selects the Softeware Command Queue Host Controller Interface,
		which will get better performance but will consume more CPU time.

		If you want, say Y or M here.

		If unsure, say N.

config DEVICE_MODULES_MMC_MTK_SW_CQHCI_DEBUG
	bool "SW CQHCI debugfor userdebug and eng load"
	depends on MMC_MTK_SW_CQHCI
	help
		control SW CQHCI debug. Record more logs
		for some seldom issue. It is only enabled
		on userdebug and eng load.

		If unsure, say N.

config DEVICE_MODULES_MMC_CQHCI_DEBUG
	tristate "Command Queue Host Controller Interface Debug"
	depends on DEVICE_MODULES_MMC_CQHCI
	help
	  This option enables debug support for the Command Queue Host
	  Controller Interface (CQHCI) in MMC (MultiMediaCard) host devices.
	  Enabling this option will allow you to obtain additional diagnostic
	  information useful for developing or troubleshooting CQHCI
	  implementations. This information is provided through debugfs and
	  can include detailed command queue state, error logs, and other
	  low-level operational details.

	  If you are a developer working on MMC host drivers or if you need
	  to troubleshoot issues with CQHCI, you may want to enable this.
	  Otherwise, it is safe to say N to avoid the overhead that comes
	  with enabling debug features.
```

## kernel/kernel_device_modules-6.6/drivers/muic/afc_gpio/Kconfig
```kconfig
config AFC_CHARGER
	tristate "Using AFC charger driver"
	default n
	help
	  If you say yes here you will get support for
	  the AFC charger driver.


config AFC_CHARGER_TEST_FOR_ON_DEVICE
	tristate "KUnit test for afc_charger_test"
	depends on KUNIT
	help
	  This is feature for afc_charger.c
	  If you run this test driver on device,
	  SHOULD set this config as 'm' to build test driver modularly.
	  refer to muic_afc_gpio.py file.

config AFC_CHARGER_TEST_FOR_ONLY_UML
	tristate "KUnit test for afc_charger_test"
	depends on KUNIT
	depends on UML
	help
	  This is feature for afc_charger.c
	  This CONFIG is recommended to set to y.
	  If you run UML test, this feature must be enabled.
	  refer to muic_afc_gpio.py file.
```

## kernel/kernel_device_modules-6.6/drivers/net/ethernet/stmicro/stmmac/Kconfig
```kconfig
# SPDX-License-Identifier: GPL-2.0-only
config DEVICE_MODULES_STMMAC_ETH
	tristate "STMicroelectronics Multi-Gigabit Ethernet driver"
	depends on HAS_IOMEM && HAS_DMA
	depends on PTP_1588_CLOCK_OPTIONAL
	select MII
	select PCS_XPCS
	select PAGE_POOL
	select PHYLINK
	select CRC32
	select RESET_CONTROLLER
	help
	  This is the driver for the Ethernet IPs built around a
	  Synopsys IP Core.

if DEVICE_MODULES_STMMAC_ETH

config DEVICE_MODULES_STMMAC_SELFTESTS
	bool "Support for STMMAC Selftests"
	depends on INET
	depends on DEVICE_MODULES_STMMAC_ETH
	default n
	help
	  This adds support for STMMAC Selftests using ethtool. Enable this
	  feature if you are facing problems with your HW and submit the test
	  results to the netdev Mailing List.

config DEVICE_MODULES_STMMAC_PLATFORM
	tristate "STMMAC Platform bus support"
	depends on DEVICE_MODULES_STMMAC_ETH
	select MFD_SYSCON
	default y
	help
	  This selects the platform specific bus support for the stmmac driver.
	  This is the driver used on several SoCs:
	  STi, Allwinner, Amlogic Meson, Altera SOCFPGA.

	  If you have a controller with this interface, say Y or M here.

	  If unsure, say N.

if DEVICE_MODULES_STMMAC_PLATFORM

config DEVICE_MODULES_DWMAC_MEDIATEK
	tristate "MediaTek MT27xx GMAC support"
	depends on OF && (ARCH_MEDIATEK || COMPILE_TEST)
	help
	  Support for MediaTek GMAC Ethernet controller.

	  This selects the MT2712 SoC support for the stmmac driver.

config DEVICE_MODULES_SGMII_PWR
	tristate "SGMII support"
	depends on OF && ARCH_MEDIATEK
	help
	  Enable MediaTek platform SGMII for fast Ethernet transmission.
	  Necessary for MediaTek Ethernet systems.
	  Provides MT8678 SGMII driver support.

	  This selects the MT8678 SGMII support.

endif

endif
```

## kernel/kernel_device_modules-6.6/drivers/net/phy/Kconfig
```kconfig
config DEVICE_MODULES_MAXLINEAR_GPHY
	tristate "Maxlinear Ethernet PHYs"
	select POLYNOMIAL if HWMON
	depends on HWMON || HWMON=n
	help
	  Support for the Maxlinear GPY115, GPY211, GPY212, GPY215,
	  GPY241, GPY245 PHYs.

config DEVICE_MODULES_REALTEK_PHY
	tristate "Realtek PHYs"
	help
	  Supports the Realtek 821x PHY.
```

## kernel/kernel_device_modules-6.6/drivers/pinctrl/mediatek/Kconfig
```kconfig
# SPDX-License-Identifier: GPL-2.0-only
menu "MediaTek pinctrl drivers"
	depends on ARCH_MEDIATEK || COMPILE_TEST

config DEVICE_MODULES_EINT_MTK
	tristate "MediaTek External Interrupt Support"
	depends on PINCTRL_MTK || PINCTRL_MTK_MOORE || DEVICE_MODULES_PINCTRL_MTK_PARIS || COMPILE_TEST
	select GPIOLIB
	select IRQ_DOMAIN
	default y if PINCTRL_MTK || PINCTRL_MTK_MOORE
	default DEVICE_MODULES_PINCTRL_MTK_PARIS

config DEVICE_MODULES_PINCTRL_MTK_V2
	tristate

config DEVICE_MODULES_PINCTRL_MTK_PARIS
	tristate
	depends on OF
	select PINMUX
	select GENERIC_PINCONF
	select GPIOLIB
	select DEVICE_MODULES_EINT_MTK
	select OF_GPIO
	select DEVICE_MODULES_PINCTRL_MTK_V2

config PINCTRL_MT6363
	tristate "Mediatek MT6363 pin control"
	depends on OF
	depends on MFD_MTK_SPMI_PMIC
	select DEVICE_MODULES_PINCTRL_MTK_PARIS
	help
	  This is the pin controller and gpio driver for mediatek
	  mt6363 chipset. It will enable mediatek common v2,
	  paris and eint core driver.
	  Say Y here to enable it.

config PINCTRL_MT6373
	tristate "Mediatek MT6373 pin control"
	depends on OF
	depends on MFD_MTK_SPMI_PMIC
	select DEVICE_MODULES_PINCTRL_MTK_PARIS
	help
	  This is the pin controller and gpio driver for mediatek
	  mt6373 chipset. It will enable mediatek common v2,
	  paris and eint core driver.
	  Say Y here to enable it.

config DEVICE_MODULES_PINCTRL_MT6779
	tristate "Mediatek MT6779 pin control"
	depends on OF
	depends on ARM64 || COMPILE_TEST
	select DEVICE_MODULES_PINCTRL_MTK_PARIS
	help
	  Say yes here to support pin controller and gpio driver
	  on Mediatek MT6779 SoC.
	  In MTK platform, we support virtual gpio and use it to
	  map specific eint which doesn't have real gpio pin.

config PINCTRL_MT6853
	tristate "Mediatek MT6853 pin control"
	depends on OF || COMPILE_TEST
	select DEVICE_MODULES_PINCTRL_MTK_PARIS

config PINCTRL_MT6873
	tristate "Mediatek MT6873 pin control"
	depends on OF || COMPILE_TEST
	select DEVICE_MODULES_PINCTRL_MTK_PARIS

config PINCTRL_MT6885
	tristate "Mediatek MT6885 MT6893 pin control"
	depends on OF || COMPILE_TEST
	select DEVICE_MODULES_PINCTRL_MTK_PARIS
	help
	  This is the pin controller and gpio driver for mediatek
	  mt6885 chipset. It will enable mediatek common v2,
	  paris and eint core driver.
	  Say Y here to enable it.

config PINCTRL_MT6886
	tristate "Mediatek MT6886 pin control"
	depends on OF || COMPILE_TEST
	select DEVICE_MODULES_PINCTRL_MTK_PARIS
	help
	  This is the pin controller and gpio driver for mediatek
	  mt6886 chipset. It will enable mediatek common v2,
	  paris and eint core driver.
	  Say Y here to enable it.

config PINCTRL_MT6897
	tristate "Mediatek MT6897 pin control"
	depends on OF || COMPILE_TEST
	select DEVICE_MODULES_PINCTRL_MTK_PARIS
	help
	  This is the pin controller and gpio driver for mediatek
	  mt6897 chipset. It will enable mediatek common v2,
	  paris and eint core driver.
	  Say Y here to enable it.

config PINCTRL_MT6899
	tristate "Mediatek MT6899 pin control"
	depends on OF || COMPILE_TEST
	select DEVICE_MODULES_PINCTRL_MTK_PARIS
	help
	  This is the pin controller and gpio driver for mediatek
	  mt6899 chipset. It will enable mediatek common v2,
	  paris and eint core driver.
	  Say Y here to enable it.

config PINCTRL_MT6983
	tristate "Mediatek MT6983 pin control"
	depends on OF || COMPILE_TEST
	select DEVICE_MODULES_PINCTRL_MTK_PARIS
	help
	  This is the pin controller and gpio driver for mediatek
	  mt6983 chipset. It will enable mediatek common v2,
	  paris and eint core driver.
	  Say Y here to enable it.

config PINCTRL_MT6985
	tristate "Mediatek MT6985 pin control"
	depends on OF || COMPILE_TEST
	select DEVICE_MODULES_PINCTRL_MTK_PARIS
	help
	  This is the pin controller and gpio driver for mediatek
	  mt6985 chipset. It will enable mediatek common v2,
	  paris and eint core driver.
	  Say Y here to enable it.

config PINCTRL_MT6768
	tristate "Mediatek MT6768 pin control"
	depends on OF || COMPILE_TEST
	select DEVICE_MODULES_PINCTRL_MTK_PARIS
	help
	  This is the pin controller and gpio driver for mediatek
	  mt6855 chipset. It will enable mediatek common v2,
	  paris and eint core driver.
	  Say Y here to enable it.

config PINCTRL_MT6833
	tristate "Mediatek MT6833 pin control"
	depends on OF || COMPILE_TEST
	select DEVICE_MODULES_PINCTRL_MTK_PARIS
	help
	  This is the pin controller and gpio driver for mediatek
	  mt6833 chipset. It will enable mediatek common v2,
	  paris and eint core driver.
	  Say Y here to enable it.

config PINCTRL_MT6761
	tristate "Mediatek MT6761 pin control"
	depends on OF || COMPILE_TEST
	select DEVICE_MODULES_PINCTRL_MTK_PARIS
	help
	  This is the pin controller and gpio driver for mediatek
	  mt6855 chipset. It will enable mediatek common v2,
	  paris and eint core driver.
	  Say Y here to enable it.

config DEVICE_MODULES_PINCTRL_MT6765
	tristate "Mediatek MT6765 pin control"
	depends on OF || COMPILE_TEST
	select DEVICE_MODULES_PINCTRL_MTK_PARIS
	help
	  This is the pin controller and gpio driver for mediatek
	  mt6765 chipset. It will enable mediatek common v2,
	  paris and eint core driver.
	  Say Y here to enable it.

config PINCTRL_MT6781
	tristate "Mediatek MT6781 pin control"
	depends on OF || COMPILE_TEST
	select DEVICE_MODULES_PINCTRL_MTK_PARIS
	help
	  This is the pin controller and gpio driver for mediatek
	  mt6765 chipset. It will enable mediatek common v2,
	  paris and eint core driver.
	  Say Y here to enable it.

config PINCTRL_MT6877
	tristate "Mediatek MT6877 pin control"
	depends on OF || COMPILE_TEST
	select DEVICE_MODULES_PINCTRL_MTK_PARIS
	help
	  This is the pin controller and gpio driver for mediatek
	  mt6855 chipset. It will enable mediatek common v2,
	  paris and eint core driver.
	  Say Y here to enable it.

config PINCTRL_MT6853
	tristate "Mediatek MT6853 pin control"
	depends on OF || COMPILE_TEST
	select DEVICE_MODULES_PINCTRL_MTK_PARIS
	help
	  This is the pin controller and gpio driver for mediatek
	  mt6855 chipset. It will enable mediatek common v2,
	  paris and eint core driver.
	  Say Y here to enable it.

config PINCTRL_MT6989
	tristate "Mediatek MT6989 pin control"
	depends on OF || COMPILE_TEST
	select DEVICE_MODULES_PINCTRL_MTK_PARIS
	help
	  This is the pin controller and gpio driver for mediatek
	  mt6989 chipset. It will enable mediatek common v2,
	  paris and eint core driver.
	  Say Y here to enable it.

config PINCTRL_MT6991
	tristate "Mediatek MT6991 pin control"
	depends on OF || COMPILE_TEST
	select DEVICE_MODULES_PINCTRL_MTK_PARIS
	help
	  This is the pin controller and gpio driver for mediatek
	  mt6991 chipset. It will enable mediatek common v2,
	  paris and eint core driver.
	  Say Y here to enable it.

config DEVICE_MODULES_PINCTRL_MT8188
	tristate "Mediatek MT8188 pin control"
	depends on OF
	depends on ARM64 || COMPILE_TEST
	select DEVICE_MODULES_PINCTRL_MTK_PARIS

config DEVICE_MODULES_PINCTRL_MT8195
	tristate "Mediatek MT8195 pin control"
	depends on OF
	depends on ARM64 || COMPILE_TEST
	select DEVICE_MODULES_PINCTRL_MTK_PARIS

config SEC_GPIO_DVS
	tristate "setting Samsung GPIO debugging and verification system"
	default n
	help
	To verify gpio configurations of devices, set this feature.
	This feature should be enabled for user-debug mode.

endmenu
```
