## vendor/mediatek/kernel_modules/connectivity/wlan/core/gen4m/configs/MT7999/defconfig
```kconfig
CONFIG_MTK_WIFI_11AX_SUPPORT=y
CONFIG_MTK_WIFI_11BE_SUPPORT=y
CONFIG_MTK_WIFI_11BE_MLO_SUPPORT=y
CONFIG_MTK_WIFI_11BE_ML_RECONFIG=y
CONFIG_MTK_WIFI_11BE_EPCS=y
CONFIG_MTK_WIFI_11BE_T2LM=y
CONFIG_MTK_WIFI_CONNAC5X=y
CONFIG_NUM_OF_WFDMA_RX_RING=3
CONFIG_NUM_OF_WFDMA_TX_RING=0
CONFIG_MTK_WIFI_UNIFIED_COMMND_SUPPORT=y
CONFIG_MTK_WIFI_TWT_SUPPORT=y
CONFIG_MTK_WIFI_TWT_STA_DIRECT_TEARDOWN=y
CONFIG_MTK_WIFI_TWT_SMART_STA=n
CONFIG_MTK_WIFI_TWT_HOTSPOT_SUPPORT=n
CONFIG_MTK_WIFI_TWT_HOTSPOT_AC_SUPPORT=n
CONFIG_MTK_WIFI_BTWT_SUPPORT=y
CONFIG_MTK_WIFI_11BE_ML_TWT_SUPPORT=y
CONFIG_MLD_LINK_MAX=2
CONFIG_DBDC_MODE=1
CONFIG_MTK_WIFI_6G_SUPPORT=y
CONFIG_SUPPORT_FORCE_ALTX=y
CONFIG_SUPPORT_TX_DATA_DELAY=y
CONFIG_SUPPORT_BW320=y
CONFIG_FILS_SK_OFFLOAD_SUPPORT=y
CONFIG_MTK_WIFI_TRX_DIRECT=y
CONFIG_NOT_CLR_FREE_MSDU_IN_DEACTIVE_NETWORK=y
CONFIG_MTK_WIFI_WFDMA_BK_RS=y
CONFIG_MTK_WIFI_WFDMA_WB=y
CONFIG_SUPPORT_WFDMA_WB_INT_MASK=y
CONFIG_NUM_OF_WFDMA_WB_TX_RING=32
CONFIG_MTK_WIFI_CONNAC3X_DS_VER=3600
CONFIG_SUPPORT_WIFI_WFDMA_TX_RING_BK_RS=y
CONFIG_MTK_WIFI_SUPPORT_PHY_FWDL=y
CONFIG_SUPPORT_TESTMODE_FWDL=n
CONFIG_ADJUST_NETIF_TH_BY_BAND=y
CONFIG_SUPPORT_TPUT_FACTOR=y
CONFIG_SUPPORT_CONTROL_PORT_OVER_NL80211=y
CONFIG_SUPPORT_BMC_DISABLE_RETRY_RTS=y
CONFIG_MTK_WIFI_SAP_PUNCTURE_SUPPORT=y
CONFIG_MTK_WIFI_SAP_CSA_PUNCTURE_SUPPORT=y
CONFIG_MTK_WIFI_SAP_BCN_CRI_UPD_SUPPORT=y
CONFIG_MTK_WIFI_SAP_TSF_DIFF_SUPPORT=y
CONFIG_SUPPORT_MLO_GRP_FRAME_XMIT=y
CONFIG_MTK_WIFI_PCIE_MSI_SUPPORT=y
CONFIG_NUM_OF_TX_CMD_RING_SIZE=512
CONFIG_SUPPORT_UNII4=y
CONFIG_TX_MAX_PKT_NUM=20000
CONFIG_PF_ARP_NS_MAX_NUM=5
CONFIG_TX_MGMT_BY_DATA_Q=y
```

## vendor/mediatek/kernel_modules/connectivity/wlan/core/gen4m_mt6653/configs/MT7925/ce_sqc/defconfig
```kconfig
# Note:  To disable feature, please set CONFIG_AAA=n.
#        "# CONFIG_AAA is not set" won't work.

# For SDK3.8 Dual Card Single Driver
CONFIG_SUPPORT_MULTI_CARD=y
```
