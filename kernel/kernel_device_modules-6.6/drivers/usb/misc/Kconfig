## kernel/kernel_device_modules-6.6/sound/soc/mediatek/Kconfig
```kconfig
# SPDX-License-Identifier: GPL-2.0-only
config DEVICE_MODULES_SND_SOC_MEDIATEK
	tristate

config SND_SOC_MTK_SMART_PHONE
	tristate "Mediatek Smart Phone PCM Operation"
	help
	  Mediatek PCM operation which is specific for
	  smart phone product.
	  Select Y if product is smart phone.
	  If unsure select "N".

config SND_SOC_MTK_SRAM
	tristate "Mediatek Audio SRAM Management"
	help
	  Mediatek Audio SRAM management for
	  normal mode and compact mode.
	  Select Y if you use this SRAM management.
	  If unsure select "N".

config SND_SOC_MT6833
	tristate "ASoC support for Mediatek MT6833 chip"
	depends on ARCH_MEDIATEK
	select CONFIG_DEVICE_MODULES_SND_SOC_MEDIATEK
	select SND_SOC_MTK_SRAM
	select SND_SOC_MTK_SMART_PHONE
	select DMA_SHARED_BUFFER
	help
	  This adds ASoC driver for Mediatek MT6833 boards
	  that can be used with other codecs.
	  Select Y if you have such device.
	  If unsure select "N".

config SND_SOC_MT6833_MT6359P
	tristate "ASoc Audio driver for MT6833 with MT6359P codec"
	depends on SND_SOC_MT6833
	select DEVICE_MODULES_SND_SOC_MT6359P
	help
	  This adds ASoC driver for Mediatek MT6833 boards
	  with the MT6359P codecs.
	  Select Y if you have such device.
	  If unsure select "N".

config SND_SOC_MT6853
	tristate "ASoC support for Mediatek MT6853 chip"
	depends on ARCH_MEDIATEK
	select DEVICE_MODULES_SND_SOC_MEDIATEK
	select SND_SOC_MTK_SRAM
	select SND_SOC_MTK_SMART_PHONE
	help
	  This adds ASoC driver for Mediatek MT6853 boards
	  that can be used with other codecs.
	  Select Y if you have such device.
	  If unsure select "N".

config SND_SOC_MT6853_MT6359P
	tristate "ASoc Audio driver for MT6853 with MT6359P codec"
	depends on SND_SOC_MT6853
	select DEVICE_MODULES_SND_SOC_MT6359P
	help
	  This adds ASoC driver for Mediatek MT6853 boards
	  with the MT6359P codecs.
	  Select Y if you have such device.
	  If unsure select "N".

config SND_SOC_MT6885
	tristate "ASoC support for Mediatek MT6885 chip"
	depends on ARCH_MEDIATEK
	select DEVICE_MODULES_SND_SOC_MEDIATEK
	select SND_SOC_MTK_SRAM
	select SND_SOC_MTK_SMART_PHONE
	select DMA_SHARED_BUFFER
	help
	  This adds ASoC driver for Mediatek MT6885 boards
	  that can be used with other codecs.
	  Select Y if you have such device.
	  If unsure select "N".

config SND_SOC_MT6885_MT6359P
	tristate "ASoc Audio driver for MT6885 with MT6359P codec"
	depends on SND_SOC_MT6885
	select DEVICE_MODULES_SND_SOC_MT6359P
	help
	  This adds ASoC driver for Mediatek MT6885 boards
	  with the MT6359P codecs.
	  Select Y if you have such device.
	  If unsure select "N".

config SND_SOC_MT6873
	tristate "ASoC support for Mediatek MT6873 chip"
	depends on ARCH_MEDIATEK
	select DEVICE_MODULES_SND_SOC_MEDIATEK
	select SND_SOC_MTK_SRAM
	select SND_SOC_MTK_SMART_PHONE
	help
	  This adds ASoC driver for Mediatek MT6873 boards
	  that can be used with other codecs.
	  Select Y if you have such device.
	  If unsure select "N".

config SND_SOC_MT6873_MT6359P
	tristate "ASoc Audio driver for MT6873 with MT6359P codec"
	depends on SND_SOC_MT6873
	select DEVICE_MODULES_SND_SOC_MT6359P
	help
	  This adds ASoC driver for Mediatek MT6873 boards
	  with the MT6359P codecs.
	  Select Y if you have such device.
	  If unsure select "N".

config SND_SOC_MT6886
	tristate "ASoC support for Mediatek MT6886 chip"
	depends on ARCH_MEDIATEK
	select DEVICE_MODULES_SND_SOC_MEDIATEK
	select SND_SOC_MTK_SRAM
	select SND_SOC_MTK_SMART_PHONE
	help
	  This adds ASoC driver for Mediatek MT6886 boards
	  that can be used with other codecs.
	  Select Y if you have such device.
	  If unsure select "N".

config SND_SOC_MT6886_MT6368
	tristate "ASoc Audio driver for MT6886 with MT6368 codec"
	depends on SND_SOC_MT6886
	select SND_SOC_MT6368
	help
	  This adds ASoC driver for Mediatek MT6886 boards
	  with the MT6368 codecs.
	  Select Y if you have such device.
	  If unsure select "N".

config SND_SOC_MT6897
	tristate "ASoC support for Mediatek MT6897 chip"
	depends on ARCH_MEDIATEK
	select DEVICE_MODULES_SND_SOC_MEDIATEK
	select SND_SOC_MTK_SRAM
	select SND_SOC_MTK_SMART_PHONE
	help
	  This adds ASoC driver for Mediatek MT6897 boards

config SND_SOC_MT6897_MT6368
	tristate "ASoc Audio driver for MT6897 with MT6368 codec"
	depends on SND_SOC_MT6897
	select SND_SOC_MT6368
	help
	  This adds ASoC driver for Mediatek MT6897 boards
	  with the MT6368 codecs.

config SND_SOC_MT6768
	tristate "ASoC support for Mediatek MT6768 chip"
	depends on ARCH_MEDIATEK
	select SND_SOC_MTK_SRAM
	select DEVICE_MODULES_SND_SOC_MEDIATEK
	select SND_SOC_MTK_SMART_PHONE
	select DMA_SHARED_BUFFER
	help
	  This adds ASoC driver for Mediatek MT6768 boards
	  that can be used with other codecs.
	  Select Y if you have such device.
	  If unsure select "N".

config SND_SOC_MT6768_MT6358
	tristate "ASoc Audio driver for MT6768 with MT6358 codec"
	depends on SND_SOC_MT6768
	select DEVICE_MODULES_SND_SOC_MT6358
	help
	  This adds ASoC driver for Mediatek MT6789 boards
	  with the MT6358 codecs.
	  Select Y if you have such device.
	  If unsure select "N".

config SND_SOC_MT6877
	tristate "ASoC support for Mediatek MT6877 chip"
	depends on ARCH_MEDIATEK
	select SND_SOC_MTK_SRAM
	select DEVICE_MODULES_SND_SOC_MEDIATEK
	select SND_SOC_MTK_SMART_PHONE
	help
	  This adds ASoC driver for Mediatek MT6877 boards
	  that can be used with other codecs.
	  Select Y if you have such device.
	  If unsure select "N".

config SND_SOC_MT6877_MT6359P
	tristate "ASoc Audio driver for MT6877 with MT6359P codec"
	depends on SND_SOC_MT6877
	select DEVICE_MODULES_SND_SOC_MT6359P
	help
	  This adds ASoC driver for Mediatek MT6877 boards
	  with the MT6359P codecs.
	  Select Y if you have such device.
	  If unsure select "N".

config SND_SOC_MT6781
	tristate "ASoC support for Mediatek MT6781 chip"
	depends on ARCH_MEDIATEK
	select SND_SOC_MTK_SRAM
	select DEVICE_MODULES_SND_SOC_MEDIATEK
	select SND_SOC_MTK_SMART_PHONE
	help
	  This adds ASoC driver for Mediatek MT6781 boards
	  that can be used with other codecs.
	  Select Y if you have such device.
	  If unsure select "N".

config SND_SOC_MT6781_MT6366
	tristate "ASoc Audio driver for MT6781 with MT6366 codec"
	depends on SND_SOC_MT6781
	select DEVICE_MODULES_SND_SOC_MT6366
	help
	  This adds ASoC driver for Mediatek MT6781 boards
	  with the MT6366 codecs.
	  Select Y if you have such device.
	  If unsure select "N".

config SND_SOC_MT6983
	tristate "ASoC support for Mediatek MT6983 chip"
	depends on ARCH_MEDIATEK
	select DEVICE_MODULES_SND_SOC_MEDIATEK
	select SND_SOC_MTK_SRAM
	select SND_SOC_MTK_SMART_PHONE
	help
	  This adds ASoC driver for Mediatek MT6983 boards
	  that can be used with other codecs.
	  Select Y if you have such device.
	  If unsure select "N".

config SND_SOC_MT6983_MT6338
	tristate "ASoc Audio driver for MT6983 with MT6338 codec"
	depends on SND_SOC_MT6983
	select SND_SOC_MT6338
	help
	  This adds ASoC driver for Mediatek MT6983 boards
	  with the MT6338 codecs.
	  Select Y if you have such device.
	  If unsure select "N".

config SND_SOC_MT6985
	tristate "ASoC support for Mediatek MT6985 chip"
	depends on ARCH_MEDIATEK
	select DEVICE_MODULES_SND_SOC_MEDIATEK
	select SND_SOC_MTK_SRAM
	select SND_SOC_MTK_SMART_PHONE
	help
	  This adds ASoC driver for Mediatek MT6985 boards
	  that can be used with other codecs.
	  Select Y if you have such device.
	  If unsure select "N".

config SND_SOC_MT6985_MT6338
	tristate "ASoc Audio driver for MT6985 with MT6338 codec"
	depends on SND_SOC_MT6985
	select SND_SOC_MT6338
	help
	  This adds ASoC driver for Mediatek MT6985 boards
	  with the MT6338 codecs.
	  Select Y if you have such device.
	  If unsure select "N".

config SND_SOC_MT6989
	tristate "ASoC support for Mediatek MT6989 chip"
	depends on ARCH_MEDIATEK
	select DEVICE_MODULES_SND_SOC_MEDIATEK
	select SND_SOC_MTK_SRAM
	select SND_SOC_MTK_SMART_PHONE
	help
	  This adds ASoC driver for Mediatek MT6989 boards
	  that can be used with other codecs.
	  Select Y if you have such device.
	  If unsure select "N".

config SND_SOC_MT6989_MT6681
	tristate "ASoc Audio driver for MT6989 with MT6681 codec"
	depends on SND_SOC_MT6989
	select SND_SOC_MT6681
	help
	  This adds ASoC driver for Mediatek MT6989 boards
	  with the MT6681 codecs.
	  Select Y if you have such device.
	  If unsure select "N".

config DEVICE_MODULES_SND_SOC_MT6991
	tristate "ASoC support for Mediatek MT6991 chip"
	depends on ARCH_MEDIATEK
	select DEVICE_MODULES_SND_SOC_MEDIATEK
	select SND_SOC_MTK_SRAM
	select SND_SOC_MTK_SMART_PHONE
	help
	  This adds ASoC driver for Mediatek MT6991 boards
	  that can be used with other codecs.
	  Select Y if you have such device.
	  If unsure select "N".

config DEVICE_MODULES_SND_SOC_MT6991_MT6681
	tristate "ASoc Audio driver for MT6991 with MT6681 codec"
	depends on DEVICE_MODULES_SND_SOC_MT6991
	select DEVICE_MODULES_SND_SOC_MT6681
	help
	  This adds ASoC driver for Mediatek MT6991 boards
	  with the MT6681 codecs.
	  Select Y if you have such device.
	  If unsure select "N".

config DEVICE_MODULES_SND_SOC_MT6899
	tristate "ASoC support for Mediatek MT6899 chip"
	depends on ARCH_MEDIATEK
	select DEVICE_MODULES_SND_SOC_MEDIATEK
	select SND_SOC_MTK_SRAM
	select SND_SOC_MTK_SMART_PHONE
	help
	  This adds ASoC driver for Mediatek MT6899 boards
	  that can be used with other codecs.
	  Select Y if you have such device.
	  If unsure select "N".

config DEVICE_MODULES_SND_SOC_MT6899_MT6368
	tristate "ASoc Audio driver for MT6899 with MT6368 codec"
	depends on DEVICE_MODULES_SND_SOC_MT6899
	select DEVICE_MODULES_SND_SOC_MT6368
	help
	  This adds ASoC driver for Mediatek MT6899 boards
	  with the MT6368 codecs.
	  Select Y if you have such device.
	  If unsure select "N".

config DEVICE_MODULES_SND_SOC_MTK_BTCVSD
	tristate "ALSA BT SCO CVSD/MSBC Driver"
	help
	  This is for software BTCVSD. This enable
	  the function for transferring/receiving
	  BT encoded data to/from BT firmware.
	  Select Y if you have such device.
	  If unsure select "N".

config SND_SOC_MTK_OFFLOAD
	tristate "Audio DSP MP3/AAC offload support"
	help
	  This add compress offload driver. This enable
	  the function for offloading MP3/AAC playback
	  to audiodsp.
	  Select Y if you have such device.
	  If unsure select "N".

config SND_SOC_MTK_AUDIO_DSP
	tristate "ASoC support for Mediatek audiodsp chip"
	depends on MTK_AUDIODSP_SUPPORT
	select SND_SOC_COMPRESS
	help
	  This adds dsp driver for Mediatek boards
	  that can be used with other platforms

config MTK_ULTRASND_PROXIMITY
	tristate "MTK ultra sound proximity support"
	help
	  For ultra sound proximity kernel driver config.
	  This ultra sound proximity kernel driver
	  cooperate with SCP ultra sound driver to
	  emulate physical proximity sensor. Using
	  IPI interface to communicate with SCP side and
	  be controlled by sensor hal.

config MTK_SND_SOC_NEW_ARCH
	bool "Support new audio architecture"
	help
	  If you say Y, enable MTK_SND_SOC_NEW_ARCH.
	  Only enable this when you use refactored audio driver architecture.
	  If new chip after mt6757, we will enable this config.
	  Audio driver refactor to common folder and platform folder.

config MTK_SND_SOC_NEW_ARCH_COMMON
	tristate "ASoc support for common drivers"
	help
	  This adds support for common drivers
	  that can be used if MTK_SND_SOC_NEW_ARCH is enabled.
	  Select Y if you have such device.
	  If unsure select "N".

config SND_SOC_CODEC_MT6357
	tristate "ASoc Audio driver for MT6357 codec"
	help
	  This adds ASoC driver for Mediatek boards
	  with the MT6357 codecs.
	  Select Y if you have such device.
	  If unsure select "N".

config SND_SOC_MT6765
	tristate "ASoC support for Mediatek MT6765 chip"
	help
	  This adds ASoC driver for Mediatek MT6765 boards
	  that can be used with other codecs.
	  Select Y if you have such device.
	  If unsure select "N".

config SND_SOC_MT8188
	tristate "ASoC support for Mediatek MT8188 chip"
	select DEVICE_MODULES_SND_SOC_MEDIATEK
	help
	  This adds ASoC platform driver support for Mediatek MT8188 chip
	  that can be used with other codecs.
	  Select Y if you have such device.
	  If unsure select "N".

config SND_SOC_MT8188_ADSP
	tristate "ADSP support for Mediatek MT8188 chip"
	depends on SND_SOC_MT8188 && MTK_HIFIXDSP_SUPPORT
	help
	  This adds ADSP platform driver support for Mediatek MT8188 chip
	  that can be used with other codecs.
	  Select Y if you have such device.
	  If unsure select "N".

config SND_SOC_MT8188_EVB
	tristate "ASoC Audio driver for MT8188 EVB"
	depends on SND_SOC_MT8188
	select DEVICE_MODULES_SND_SOC_HDMI_CODEC
	help
	  This adds ASoC driver for Mediatek MT8188 boards
	  with the PMIC Audio.
	  Select Y if you have such device.
	  If unsure select "N".

config MTK_SCP_AUDIO
	tristate "ASoC support for Mediatek scp audio chip"
	help
	  This adds scp audio driver for Mediatek boards
	  that can be used with other platforms
	  Select Y if you have such device.
	  If unsure select "N".
+config MTK_USIP_DRIVER
	tristate "Enable usip driver"
	help
	  This option enable mtk-usip driver support.
	  Select Y if need support mtk-usip driver.
	  If unsure select "N".

config NEBULA_SND_PASSTHROUGH
	tristate "ASoC support for Hypervisor Passthrough"
	help
	  This adds hypervisor passthrough path for Mediatek boards
	  that can be used with other platforms
	  Select Y if you have such device.
	  If unsure select "N".

config SND_SOC_MTK_AUTO_AUDIO
	tristate "ASoC audio driver support for Mediatek auto boards"
	help
	  This adds ASoC audio driver for Mediatek auto boards
          that can be used with other platforms
	  Select Y if you have such device.
	  If unsure select "N".

config ADSP_SLB_LEGACY
	bool "Enable legacy SLB support only for legacy chips"
	depends on MTK_SLBC
	default n
	help
	  Enable this option to provide support for legacy SLB (System Level Bus) on older chips that do not
	  support SLC (System Level Cache). Newer architectures support both SLB and SLC, but legacy chips
	  only support SLB.
	  If you are unsure, it is safe to select "N".

	  This option is specifically for older Mediatek chips that rely on SLB for system-level bus
	  management. Enabling this will ensure compatibility and proper functioning of the bus system on
	  these legacy chips. Note that this is not required for newer chips that have SLC support.
```

## kernel/kernel_device_modules-6.6/sound/soc/samsung/Kconfig
```kconfig
# SPDX-License-Identifier: GPL-2.0-only

# SEC AUDIO
config SND_SOC_SAMSUNG_AUDIO
	tristate "Audio support for Samsung Projects"
	help
	  Say Y here to enable audio support for the Samsung Audio.
```

## kernel/kernel_device_modules-6.6/sound/virtio/Kconfig
```kconfig
# SPDX-License-Identifier: GPL-2.0+
# Sound card driver for virtio

config SND_VIRTIO_MTK_PASSTHROUGH
	bool "Support virtio sound MTK passthrough mode"
	help
	  This option enables support for the virtio sound MTK passthrough mode,
	  which allows for PCM passthrough feature on MTK platforms.

	  Select this option if you want to enable PCM passthrough feature for
	  sound devices on MTK platforms using the virtio sound driver.

config SND_VIRTIO
	tristate "Virtio sound driver"
	depends on VIRTIO
	select SND_PCM
	select SND_JACK
	help
	  This is the virtual sound driver for virtio. It provides support for
	  sound devices in virtualized environments using the virtio framework.
	  Select Y to build the driver into the kernel or M to build it as a
	  loadable module.
```

## vendor/mediatek/kernel_modules/connectivity/wlan/core/gen4m/configs/MT7925/ce_devfeature/defconfig
```kconfig
# Note:  To disable feature, please set CONFIG_AAA=n.
#        "# CONFIG_AAA is not set" won't work.

CONFIG_SUPPORT_MLO_HYBRID=y
CONFIG_SUPPORT_FORCE_LINK_SORT=y
```
